## buildroot/package/ethtool/Config.in
```kconfig
if BR2_BUILD_USE_ASTLINUX_SCRIPTS

include package/ethtool/astlinux/Config.in

else #BR2_BUILD_USE_CUSTOM_SCRIPTS

config BR2_PACKAGE_ETHTOOL
	bool "ethtool"
	help
	  ethtool is a small utility for examining and tuning your
	  ethernet-based network interface.

	  https://www.kernel.org/pub/software/network/ethtool/

config BR2_PACKAGE_ETHTOOL_PRETTY_PRINT
	bool "enable pretty printing"
	default y
	depends on BR2_PACKAGE_ETHTOOL
	help
	  Enables ethtool's pretty printing for drivers
	  and SFP modules.

endif #BR2_BUILD_USE_CUSTOM_SCRIPTS
```

## buildroot/package/expat/Config.in
```kconfig
if BR2_BUILD_USE_CUSTOM_SCRIPTS
if BR2_BUILD_USE_ASTLINUX_SCRIPTS

config BR2_PACKAGE_EXPAT
	bool"expat"
	help
	  The Expat XML Parser.

	  http://expat.sourceforge.net

endif

endif #BR2_BUILD_USE_CUSTOM_SCRIPTS

if !BR2_BUILD_USE_CUSTOM_SCRIPTS

config BR2_PACKAGE_EXPAT
	bool "expat"
	help
	  The Expat XML Parser.

	  https://libexpat.github.io/

endif #!BR2_BUILD_USE_CUSTOM_SCRIPTS
```

## buildroot/package/flex/Config.in
```kconfig
if BR2_BUILD_USE_CUSTOM_SCRIPTS
if BR2_BUILD_USE_ASTLINUX_SCRIPTS

config BR2_PACKAGE_FLEX
	bool "flex"
	help
	  A fast lexical analyser generator.  A tool for generating
	  programs that perform pattern-matching on text.

	  http://flex.sourceforge.net/


endif

endif #BR2_BUILD_USE_CUSTOM_SCRIPTS

if !BR2_BUILD_USE_CUSTOM_SCRIPTS

config BR2_PACKAGE_FLEX
	bool "flex"
	help
	  A fast lexical analyser generator. A tool for generating
	  programs that perform pattern-matching on text.

	  Only the library is available.

	  https://github.com/westes/flex/

endif #!BR2_BUILD_USE_CUSTOM_SCRIPTS
```

## buildroot/package/fping/Config.in
```kconfig
if BR2_BUILD_USE_CUSTOM_SCRIPTS
if BR2_BUILD_USE_ASTLINUX_SCRIPTS

config BR2_PACKAGE_FPING
	bool "fping"
	default n
	help
	  fping is a program to send ICMP echo probes to network hosts, similar to ping,
	  but much better performing when pinging multiple hosts. fping has a very
	  long history: Roland Schemers did publish a first version of it in 1992 and it has
	  established itself since then as a standard tool for network diagnostics and statistics.

	  http://fping.org/


endif

endif #BR2_BUILD_USE_CUSTOM_SCRIPTS

if !BR2_BUILD_USE_CUSTOM_SCRIPTS

config BR2_PACKAGE_FPING
	bool "fping"
	help
	  fping is a program to send ICMP echo probes to network hosts,
	  similar to ping, but much better performing when pinging
	  multiple hosts.

	  http://fping.org/

endif #!BR2_BUILD_USE_CUSTOM_SCRIPTS
```

## buildroot/package/genext2fs/Config.in
```kconfig
if BR2_BUILD_USE_CUSTOM_SCRIPTS
if BR2_BUILD_USE_ASTLINUX_SCRIPTS
source package/genext2fs/astlinux/Config.in
endif

endif #BR2_BUILD_USE_CUSTOM_SCRIPTS

if !BR2_BUILD_USE_CUSTOM_SCRIPTS

config BR2_PACKAGE_GENEXT2FS
	bool "genext2fs"
	help
	  genext2fs generates an ext2 filesystem as a normal (non-root)
	  user. It does not require you to mount the image file to
	  copy files on it, nor does it require that you become the
	  superuser to make device nodes.

	  http://genext2fs.sourceforge.net/

endif #!BR2_BUILD_USE_CUSTOM_SCRIPTS
```

## buildroot/package/gperf/Config.in
```kconfig
if BR2_BUILD_USE_CUSTOM_SCRIPTS
if BR2_BUILD_USE_ASTLINUX_SCRIPTS
source package/gperf/astlinux/Config.in
endif

endif #BR2_BUILD_USE_CUSTOM_SCRIPTS

if !BR2_BUILD_USE_CUSTOM_SCRIPTS

config BR2_PACKAGE_GPERF
	bool "gperf"
	depends on BR2_INSTALL_LIBSTDCPP
	help
	  A 'perfect hash function' generator

	  http://www.gnu.org/software/gperf/

comment "gperf needs a toolchain w/ C++"
	depends on !BR2_INSTALL_LIBSTDCPP

endif #!BR2_BUILD_USE_CUSTOM_SCRIPTS
```

## buildroot/package/htop/Config.in
```kconfig
if BR2_BUILD_USE_CUSTOM_SCRIPTS
if BR2_BUILD_USE_ASTLINUX_SCRIPTS

config BR2_PACKAGE_HTOP
	bool "htop"
	select BR2_PACKAGE_NCURSES
	help
	  htop is a cross-platform interactive process viewer.
	  It is a text-mode application (for console or X terminals)
	  and requires ncurses.

	  https://htop.dev/
	  https://github.com/htop-dev/htop/releases


endif

endif #BR2_BUILD_USE_CUSTOM_SCRIPTS

if !BR2_BUILD_USE_CUSTOM_SCRIPTS

config BR2_PACKAGE_HTOP
	bool "htop"
	depends on BR2_USE_MMU # fork()
	depends on !BR2_STATIC_LIBS # dlopen()
	select BR2_PACKAGE_NCURSES
	help
	  htop is an interactive text-mode process viewer for Linux.
	  It aims to be a better top.

	  https://htop.dev/

comment "htop needs a toolchain w/ dynamic library"
	depends on BR2_USE_MMU
	depends on BR2_STATIC_LIBS

endif #!BR2_BUILD_USE_CUSTOM_SCRIPTS
```

## buildroot/package/iperf/Config.in
```kconfig
if BR2_BUILD_USE_CUSTOM_SCRIPTS
if BR2_BUILD_USE_ASTLINUX_SCRIPTS

config BR2_PACKAGE_IPERF
	bool "iperf"
	depends on BR2_INSTALL_LIBSTDCPP
	help
	  Internet Protocol bandwidth measuring tool for measuring
	  TCP/UDP performance.

	  https://sourceforge.net/projects/iperf2/

comment "iperf requires a toolchain with C++ support enabled"
	depends on !BR2_INSTALL_LIBSTDCPP

endif

endif #BR2_BUILD_USE_CUSTOM_SCRIPTS

if !BR2_BUILD_USE_CUSTOM_SCRIPTS

config BR2_PACKAGE_IPERF
	bool "iperf"
	depends on BR2_INSTALL_LIBSTDCPP
	# uses fork()
	depends on BR2_USE_MMU
	help
	  Internet Protocol bandwidth measuring tool for measuring
	  TCP/UDP performance.

	  https://sourceforge.net/projects/iperf2/

comment "iperf needs a toolchain w/ C++"
	depends on BR2_USE_MMU
	depends on !BR2_INSTALL_LIBSTDCPP

endif #!BR2_BUILD_USE_CUSTOM_SCRIPTS
```

## buildroot/package/ipset/Config.in
```kconfig
if BR2_BUILD_USE_CUSTOM_SCRIPTS
if BR2_BUILD_USE_ASTLINUX_SCRIPTS
source package/ipset/astlinux/Config.in
endif

endif #BR2_BUILD_USE_CUSTOM_SCRIPTS

if !BR2_BUILD_USE_CUSTOM_SCRIPTS

config BR2_PACKAGE_IPSET
	bool "ipset"
	select BR2_PACKAGE_LIBMNL
	help
	  Utility to manage IP sets in the linux kernel.
	  Requires a patched kernel or version >=2.6.39.

	  http://ipset.netfilter.org/

endif #!BR2_BUILD_USE_CUSTOM_SCRIPTS
```

## buildroot/package/jansson/Config.in
```kconfig
if BR2_BUILD_USE_CUSTOM_SCRIPTS
if BR2_BUILD_USE_ASTLINUX_SCRIPTS

config BR2_PACKAGE_JANSSON
	bool "jansson"
	help
	  Jansson is a C library for encoding, decoding and manipulating JSON
	  data.

	  http://www.digip.org/jansson/


endif

endif #BR2_BUILD_USE_CUSTOM_SCRIPTS

if !BR2_BUILD_USE_CUSTOM_SCRIPTS

config BR2_PACKAGE_JANSSON
	bool "jansson"
	help
	  Jansson is a C library for encoding, decoding and manipulating
	  JSON data.

	  http://www.digip.org/jansson/

endif #!BR2_BUILD_USE_CUSTOM_SCRIPTS
```

## buildroot/package/keepalived/Config.in
```kconfig
if BR2_BUILD_USE_CUSTOM_SCRIPTS
if BR2_BUILD_USE_ASTLINUX_SCRIPTS

config BR2_PACKAGE_KEEPALIVED
	bool "keepalived"
	depends on BR2_USE_MMU
	depends on BR2_LINUX_KERNEL
	select BR2_PACKAGE_OPENSSL
	help
	  The main goal of this project is to provide simple and robust
	  facilities for loadbalancing and high-availability to Linux
	  system and Linux based infrastructures. Loadbalancing framework
	  relies on well-known and widely used Linux Virtual Server (IPVS)
	  kernel module providing Layer4 loadbalancing. Keepalived
	  implements a set of checkers to dynamically and adaptively
	  maintain and manage loadbalanced server pool according their health.

	  http://www.keepalived.org/


endif

endif #BR2_BUILD_USE_CUSTOM_SCRIPTS

if !BR2_BUILD_USE_CUSTOM_SCRIPTS

config BR2_PACKAGE_KEEPALIVED
	bool "keepalived"
	depends on BR2_USE_MMU
	depends on !BR2_STATIC_LIBS # uses libdl
	select BR2_PACKAGE_OPENSSL
	help
	  The main goal of the keepalived project is to add a strong &
	  robust keepalive facility to the Linux Virtual Server
	  project. It implements a multilayer TCP/IP stack
	  checks. Keepalived implements a framework based on three
	  family checks: Layer3, Layer4 & Layer5. This framework gives
	  the daemon the ability of checking a LVS server pool
	  states. Keepalived can be summarized as a LVS driving daemon.

	  http://www.keepalived.org/

comment "keepalived needs a toolchain w/ dynamic library"
	depends on BR2_USE_MMU
	depends on BR2_STATIC_LIBS

endif #!BR2_BUILD_USE_CUSTOM_SCRIPTS
```

## buildroot/package/kmod/Config.in
```kconfig
if BR2_BUILD_USE_CUSTOM_SCRIPTS
if BR2_BUILD_USE_ASTLINUX_SCRIPTS

config BR2_PACKAGE_KMOD
	bool "kmod"
	help
	  handle kernel modules

	  https://git.kernel.org/pub/scm/utils/kernel/kmod/kmod.git

if BR2_PACKAGE_KMOD

config BR2_PACKAGE_KMOD_TOOLS
	bool "kmod utilities"
	help
	  Install kmod module utilities (depmod, insmod, lsmod,
	  modinfo, modprobe, rmmod).

endif


endif

endif #BR2_BUILD_USE_CUSTOM_SCRIPTS

if !BR2_BUILD_USE_CUSTOM_SCRIPTS

config BR2_PACKAGE_KMOD
	bool "kmod"
	depends on !BR2_STATIC_LIBS
	help
	  handle kernel modules

	  http://git.kernel.org/?p=utils/kernel/kmod/kmod.git

if BR2_PACKAGE_KMOD

config BR2_PACKAGE_KMOD_TOOLS
	bool "kmod utilities"
	depends on BR2_PACKAGE_BUSYBOX_SHOW_OTHERS
	help
	  Install kmod module utilities (depmod, insmod, lsmod,
	  modinfo, modprobe, rmmod).

endif

comment "kmod needs a toolchain w/ dynamic library"
	depends on BR2_STATIC_LIBS

endif #!BR2_BUILD_USE_CUSTOM_SCRIPTS
```

## buildroot/package/libdaemon/Config.in
```kconfig
if BR2_BUILD_USE_CUSTOM_SCRIPTS
if BR2_BUILD_USE_ASTLINUX_SCRIPTS
source package/libdaemon/astlinux/Config.in
endif

endif #BR2_BUILD_USE_CUSTOM_SCRIPTS

if !BR2_BUILD_USE_CUSTOM_SCRIPTS

config BR2_PACKAGE_LIBDAEMON
	bool "libdaemon"
	# needs fork()
	depends on BR2_USE_MMU
	help
	  libdaemon is a lightweight C library that eases the
	  writing of UNIX daemons.

	  http://0pointer.de/lennart/projects/libdaemon/

endif #!BR2_BUILD_USE_CUSTOM_SCRIPTS
```

## buildroot/package/libfuse/Config.in
```kconfig
if BR2_BUILD_USE_ASTLINUX_SCRIPTS

include package/libfuse/astlinux/Config.in

else #BR2_BUILD_USE_CUSTOM_SCRIPTS

config BR2_PACKAGE_LIBFUSE
	bool "libfuse"
	# Really doesn't like static, see fuse/lib/fuse.c
	depends on !BR2_STATIC_LIBS
	depends on BR2_TOOLCHAIN_HAS_THREADS
	depends on BR2_USE_MMU # fork()
	help
	  FUSE (Filesystem in UserSpacE)

	  https://github.com/libfuse/libfuse

comment "libfuse needs a toolchain w/ threads, dynamic library"
	depends on BR2_USE_MMU
	depends on !BR2_TOOLCHAIN_HAS_THREADS || BR2_STATIC_LIBS

endif #BR2_BUILD_USE_CUSTOM_SCRIPTS
```

## buildroot/package/libical/Config.in
```kconfig
if BR2_BUILD_USE_CUSTOM_SCRIPTS
if BR2_BUILD_USE_ASTLINUX_SCRIPTS

config BR2_PACKAGE_LIBICAL
	bool "libical"
	depends on BR2_USE_WCHAR
	help
	  libical is an Open Source (MPL/LGPL) implementation of the IETF's
	  iCalendar Calendaring and Scheduling protocols.

	  http://www.citadel.org/doku.php/documentation:featured_projects:libical

comment "libical requires a toolchain with WCHAR support"
	depends on !BR2_USE_WCHAR


endif

endif #BR2_BUILD_USE_CUSTOM_SCRIPTS

if !BR2_BUILD_USE_CUSTOM_SCRIPTS

config BR2_PACKAGE_LIBICAL
	bool "libical"
	depends on BR2_INSTALL_LIBSTDCPP
	depends on !BR2_STATIC_LIBS
	depends on BR2_USE_WCHAR
	select BR2_TARGET_TZ_INFO
	help
	  libical is an Open Source (MPL/LGPL) implementation of the
	  IETF's iCalendar Calendaring and Scheduling protocols.

	  http://libical.github.io/libical

comment "libical needs a toolchain w/ C++, dynamic library, wchar"
	depends on !BR2_INSTALL_LIBSTDCPP || !BR2_USE_WCHAR || \
		BR2_STATIC_LIBS

endif #!BR2_BUILD_USE_CUSTOM_SCRIPTS
```

## buildroot/package/libidn/Config.in
```kconfig
if BR2_BUILD_USE_CUSTOM_SCRIPTS
if BR2_BUILD_USE_ASTLINUX_SCRIPTS

config BR2_PACKAGE_LIBIDN
	bool "libidn"
	select BR2_PACKAGE_GETTEXT if BR2_NEEDS_GETTEXT_IF_LOCALE
	help
	  Libidn's purpose is to encode and decode internationalized
	  domain names.

	  http://www.gnu.org/software/libidn/

config BR2_PACKAGE_LIBIDN_BINARY
	bool "idn binary"
	depends on BR2_PACKAGE_LIBIDN
	help
	  Install idn command line tool

endif

endif #BR2_BUILD_USE_CUSTOM_SCRIPTS

if !BR2_BUILD_USE_CUSTOM_SCRIPTS

config BR2_PACKAGE_LIBIDN
	bool "libidn"
	help
	  Libidn's purpose is to encode and decode internationalized
	  domain names.

	  http://www.gnu.org/software/libidn/

if BR2_PACKAGE_LIBIDN

config BR2_PACKAGE_LIBIDN_BINARY
	bool "idn binary"
	help
	  Install idn command line tool

endif

endif #!BR2_BUILD_USE_CUSTOM_SCRIPTS
```

## buildroot/package/libjpeg/astlinux/Config.in
```kconfig
config BR2_PACKAGE_LIBJPEG
	bool "libjpeg"
	help
	  The ubiquitous C library for manipulating LIBJPEG images.

	  http://www.ijg.org/
```

## buildroot/package/libmnl/Config.in
```kconfig
if BR2_BUILD_USE_ASTLINUX_SCRIPTS

include package/libmnl/astlinux/Config.in

else #BR2_BUILD_USE_CUSTOM_SCRIPTS

config BR2_PACKAGE_LIBMNL
	bool "libmnl"
	help
	  libmnl is a minimalistic user-space library oriented
	  to Netlink developers.

	  http://netfilter.org/projects/libmnl/

if BR2_PACKAGE_LIBMNL

config BR2_PACKAGE_LIBMNL_EXAMPLES
	bool "install examples"
	help
	  Install binary examples.

endif

endif #BR2_BUILD_USE_CUSTOM_SCRIPTS
```

## buildroot/package/libpcap/Config.in
```kconfig
if BR2_BUILD_USE_CUSTOM_SCRIPTS
if BR2_BUILD_USE_ASTLINUX_SCRIPTS

config BR2_PACKAGE_LIBPCAP
	bool "libpcap"
	select BR2_PACKAGE_ZLIB
	help
	  A system-independent library for user-level network packet capture.

	  http://www.tcpdump.org/

endif

endif #BR2_BUILD_USE_CUSTOM_SCRIPTS

if !BR2_BUILD_USE_CUSTOM_SCRIPTS

config BR2_PACKAGE_LIBPCAP
	bool "libpcap"
	select BR2_PACKAGE_BLUEZ5_UTILS_HEADERS if BR2_PACKAGE_BLUEZ5_UTILS
	help
	  A system-independent library for user-level network packet
	  capture.

	  https://www.tcpdump.org/

endif #!BR2_BUILD_USE_CUSTOM_SCRIPTS
```
