## buildroot/package/libpng/Config.in
```kconfig
if BR2_BUILD_USE_CUSTOM_SCRIPTS
if BR2_BUILD_USE_ASTLINUX_SCRIPTS
source package/libpng/astlinux/Config.in
endif

endif #BR2_BUILD_USE_CUSTOM_SCRIPTS

if !BR2_BUILD_USE_CUSTOM_SCRIPTS

config BR2_PACKAGE_LIBPNG
	bool "libpng"
	select BR2_PACKAGE_ZLIB
	help
	  Library for handling PNG (Portable Network Graphics)
	  images.

	  http://www.libpng.org/

endif #!BR2_BUILD_USE_CUSTOM_SCRIPTS
```

## buildroot/package/libsodium/Config.in
```kconfig
if BR2_BUILD_USE_CUSTOM_SCRIPTS
if BR2_BUILD_USE_ASTLINUX_SCRIPTS

config BR2_PACKAGE_LIBSODIUM
	bool "libsodium"
	default n
	help
	  Sodium is a portable, cross-compilable, installable, packageable
	  fork of the NaCl Cryptograpy & Networking library, with a compatible API.

	  http://github.com/jedisct1/libsodium

endif

endif #BR2_BUILD_USE_CUSTOM_SCRIPTS

if !BR2_BUILD_USE_CUSTOM_SCRIPTS

config BR2_PACKAGE_LIBSODIUM
	bool "libsodium"
	help
	  A modern and easy-to-use crypto library.

	  http://libsodium.org/

if BR2_PACKAGE_LIBSODIUM

config BR2_PACKAGE_LIBSODIUM_FULL
	bool "all functions"
	default y
	help
	  Build all seldom used and obsolete functions. Without
	  this option, only the minimal set of normally used
	  functions is built.

endif

endif #!BR2_BUILD_USE_CUSTOM_SCRIPTS
```

## buildroot/package/libsrtp/Config.in
```kconfig
if BR2_BUILD_USE_CUSTOM_SCRIPTS
if BR2_BUILD_USE_ASTLINUX_SCRIPTS

config BR2_PACKAGE_LIBSRTP
	bool "libsrtp"
 	default n
	select BR2_PACKAGE_OPENSSL
	help
	  The libSRTP library is an open-source implementation of the
	  Secure Real-time Transport Protocol (SRTP) originally authored
	  by Cisco Systems, Inc. It is available under a BSD-style license.

	  https://github.com/cisco/libsrtp

endif

endif #BR2_BUILD_USE_CUSTOM_SCRIPTS

if !BR2_BUILD_USE_CUSTOM_SCRIPTS

config BR2_PACKAGE_LIBSRTP
	bool "libsrtp"
	help
	  This package provides an implementation of the Secure
	  Real-time Transport Protocol (SRTP), the Universal Security
	  Transform (UST), and a supporting cryptographic kernel.

	  https://github.com/cisco/libsrtp

endif #!BR2_BUILD_USE_CUSTOM_SCRIPTS
```

## buildroot/package/libtool/Config.in
```kconfig
if BR2_BUILD_USE_CUSTOM_SCRIPTS
if BR2_BUILD_USE_ASTLINUX_SCRIPTS
source package/libtool/astlinux/Config.in
endif

endif #BR2_BUILD_USE_CUSTOM_SCRIPTS

if !BR2_BUILD_USE_CUSTOM_SCRIPTS

config BR2_PACKAGE_LIBTOOL
	bool "libtool"
	help
	  Library that hides the complexity of using shared/static
	  libraries on different platforms behind a consistent, portable
	  interface.

	  http://www.gnu.org/software/libtool/

endif #!BR2_BUILD_USE_CUSTOM_SCRIPTS
```

## buildroot/package/liburiparser/Config.in
```kconfig
if BR2_BUILD_USE_CUSTOM_SCRIPTS
if BR2_BUILD_USE_ASTLINUX_SCRIPTS
source package/liburiparser/astlinux/Config.in
endif

endif #BR2_BUILD_USE_CUSTOM_SCRIPTS

if !BR2_BUILD_USE_CUSTOM_SCRIPTS

config BR2_PACKAGE_LIBURIPARSER
	bool "liburiparser"
	help
	  uriparser is a strictly RFC 3986 compliant URI parsing and
	  handling library written in C.

	  https://uriparser.github.io

endif #!BR2_BUILD_USE_CUSTOM_SCRIPTS
```

## buildroot/package/libusb-compat/Config.in
```kconfig
if BR2_BUILD_USE_ASTLINUX_SCRIPTS

include package/libusb-compat/astlinux/Config.in

else #BR2_BUILD_USE_CUSTOM_SCRIPTS

config BR2_PACKAGE_LIBUSB_COMPAT
	bool "libusb-compat"
	depends on BR2_PACKAGE_LIBUSB
	help
	  libusb-0.1 compatibility layer for libusb-1.0.

	  http://libusb.info/

endif #BR2_BUILD_USE_CUSTOM_SCRIPTS
```

## buildroot/package/libusb/Config.in
```kconfig
if BR2_BUILD_USE_CUSTOM_SCRIPTS
if BR2_BUILD_USE_ASTLINUX_SCRIPTS
source package/libusb/astlinux/Config.in
endif

endif #BR2_BUILD_USE_CUSTOM_SCRIPTS

if !BR2_BUILD_USE_CUSTOM_SCRIPTS

config BR2_PACKAGE_LIBUSB
	bool "libusb"
	depends on BR2_TOOLCHAIN_HAS_THREADS
	depends on BR2_TOOLCHAIN_GCC_AT_LEAST_4_9 # _Thread_local
	help
	  Userspace library for accessing USB devices

	  http://libusb.info/

if BR2_PACKAGE_LIBUSB

config BR2_PACKAGE_LIBUSB_EXAMPLES
	bool "build libusb examples"

endif

comment "libusb needs a toolchain w/ threads, gcc >= 4.9"
	depends on !BR2_TOOLCHAIN_HAS_THREADS || \
		!BR2_TOOLCHAIN_GCC_AT_LEAST_4_9

endif #!BR2_BUILD_USE_CUSTOM_SCRIPTS
```

## buildroot/package/libxml2/Config.in
```kconfig
if BR2_BUILD_USE_CUSTOM_SCRIPTS
if BR2_BUILD_USE_ASTLINUX_SCRIPTS
source package/libxml2/astlinux/Config.in
endif

endif #BR2_BUILD_USE_CUSTOM_SCRIPTS

if !BR2_BUILD_USE_CUSTOM_SCRIPTS

config BR2_PACKAGE_LIBXML2
	bool "libxml2"
	help
	  XML C Parser

	  http://xmlsoft.org/

endif #!BR2_BUILD_USE_CUSTOM_SCRIPTS
```

## buildroot/package/libzlib/astlinux/Config.in
```kconfig
config BR2_PACKAGE_LIBZLIB
	bool "libzlib"
	help
	  Standard (de)compression library.  Used by things like
	  gzip and libpng.

	  https://zlib.net/
```

## buildroot/package/logrotate/Config.in
```kconfig
if BR2_BUILD_USE_CUSTOM_SCRIPTS
if BR2_BUILD_USE_ASTLINUX_SCRIPTS
source package/logrotate/astlinux/Config.in
endif

endif #BR2_BUILD_USE_CUSTOM_SCRIPTS

if !BR2_BUILD_USE_CUSTOM_SCRIPTS

config BR2_PACKAGE_LOGROTATE
	bool "logrotate"
	depends on BR2_USE_WCHAR
	depends on BR2_USE_MMU # fork()
	select BR2_PACKAGE_POPT
	help
	  A simple program to rotate logs.

	  https://github.com/logrotate/logrotate

comment "logrotate needs a toolchain w/ wchar"
	depends on BR2_USE_MMU
	depends on !BR2_USE_WCHAR

endif #!BR2_BUILD_USE_CUSTOM_SCRIPTS
```

## buildroot/package/lua/astlinux/Config.in
```kconfig
config BR2_PACKAGE_LUA
	bool "lua"
	select BR2_PACKAGE_HAS_LUAINTERPRETER
	help
	  Lua is a powerful, fast, light-weight, embeddable scripting language.

	  http://www.lua.org/

if BR2_PACKAGE_LUA

config BR2_PACKAGE_PROVIDES_LUAINTERPRETER
	default "lua"

endif
```

## buildroot/package/luabitop/Config.in
```kconfig
if BR2_BUILD_USE_CUSTOM_SCRIPTS
if BR2_BUILD_USE_ASTLINUX_SCRIPTS

config BR2_PACKAGE_LUABITOP
	bool "luabitop"
	help
	  Lua BitOp is a C extension module for Lua 5.1
	  which adds bitwise operations on numbers.

	  https://bitop.luajit.org/

endif

endif #BR2_BUILD_USE_CUSTOM_SCRIPTS

if !BR2_BUILD_USE_CUSTOM_SCRIPTS

config BR2_PACKAGE_LUABITOP
	bool "luabitop"
	depends on BR2_PACKAGE_LUA_5_1
	help
	  Lua BitOp is a C extension module for Lua 5.1/5.2 which adds
	  bitwise operations on numbers.

	  http://bitop.luajit.org

comment "luabitop needs Lua 5.1"
	depends on !BR2_PACKAGE_LUA_5_1

endif #!BR2_BUILD_USE_CUSTOM_SCRIPTS
```

## buildroot/package/luaexpat/Config.in
```kconfig
if BR2_BUILD_USE_CUSTOM_SCRIPTS
if BR2_BUILD_USE_ASTLINUX_SCRIPTS

config BR2_PACKAGE_LUAEXPAT
	bool "luaexpat"
	select BR2_PACKAGE_EXPAT
	help
	  LuaExpat is a SAX XML parser based on the Expat library.

	  https://lunarmodules.github.io/luaexpat


endif

endif #BR2_BUILD_USE_CUSTOM_SCRIPTS

if !BR2_BUILD_USE_CUSTOM_SCRIPTS

config BR2_PACKAGE_LUAEXPAT
	bool "luaexpat"
	select BR2_PACKAGE_EXPAT
	help
	  LuaExpat is a SAX XML parser based on the Expat library.

	  https://lunarmodules.github.io/luaexpat

endif #!BR2_BUILD_USE_CUSTOM_SCRIPTS
```

## buildroot/package/luafilesystem/Config.in
```kconfig
if BR2_BUILD_USE_CUSTOM_SCRIPTS
if BR2_BUILD_USE_ASTLINUX_SCRIPTS

config BR2_PACKAGE_LUAFILESYSTEM
	bool "luafilesystem"
	help
	  LuaFileSystem offers a portable way to access
	  the underlying directory structure and file attributes.

	  http://keplerproject.github.com/luafilesystem/

endif

endif #BR2_BUILD_USE_CUSTOM_SCRIPTS

if !BR2_BUILD_USE_CUSTOM_SCRIPTS

config BR2_PACKAGE_LUAFILESYSTEM
	bool "luafilesystem"
	help
	  LuaFileSystem offers a portable way to access
	  the underlying directory structure and file attributes.

	  http://keplerproject.github.com/luafilesystem/

endif #!BR2_BUILD_USE_CUSTOM_SCRIPTS
```

## buildroot/package/luasec/Config.in
```kconfig
if BR2_BUILD_USE_CUSTOM_SCRIPTS
if BR2_BUILD_USE_ASTLINUX_SCRIPTS
source package/luasec/astlinux/Config.in
endif

endif #BR2_BUILD_USE_CUSTOM_SCRIPTS

if !BR2_BUILD_USE_CUSTOM_SCRIPTS

config BR2_PACKAGE_LUASEC
	bool "luasec"
	select BR2_PACKAGE_OPENSSL
	select BR2_PACKAGE_LUASOCKET # runtime
	help
	  A binding for OpenSSL library to provide TLS/SSL communication
	  over LuaSocket.

	  https://github.com/brunoos/luasec/wiki

endif #!BR2_BUILD_USE_CUSTOM_SCRIPTS
```

## buildroot/package/luasocket/Config.in
```kconfig
if BR2_BUILD_USE_CUSTOM_SCRIPTS
if BR2_BUILD_USE_ASTLINUX_SCRIPTS
source package/luasocket/astlinux/Config.in
endif

endif #BR2_BUILD_USE_CUSTOM_SCRIPTS

if !BR2_BUILD_USE_CUSTOM_SCRIPTS

config BR2_PACKAGE_LUASOCKET
	bool "luasocket"
	help
	  LuaSocket is the most comprehensive networking support library
	  for the Lua language.
	  It provides easy access to TCP, UDP, DNS, SMTP,
	  FTP, HTTP, MIME and much more.

	  https://github.com/lunarmodules/luasocket

endif #!BR2_BUILD_USE_CUSTOM_SCRIPTS
```

## buildroot/package/lzo/Config.in
```kconfig
if BR2_BUILD_USE_CUSTOM_SCRIPTS
if BR2_BUILD_USE_ASTLINUX_SCRIPTS
source package/lzo/astlinux/Config.in
endif

endif #BR2_BUILD_USE_CUSTOM_SCRIPTS

if !BR2_BUILD_USE_CUSTOM_SCRIPTS

config BR2_PACKAGE_LZO
	bool "lzo"
	help
	  Portable lossless data compression library written in ANSI C.

	  http://www.oberhumer.com/opensource/lzo/

endif #!BR2_BUILD_USE_CUSTOM_SCRIPTS
```

## buildroot/package/monit/Config.in
```kconfig
if BR2_BUILD_USE_CUSTOM_SCRIPTS
if BR2_BUILD_USE_ASTLINUX_SCRIPTS
source package/monit/astlinux/Config.in
endif

endif #BR2_BUILD_USE_CUSTOM_SCRIPTS

if !BR2_BUILD_USE_CUSTOM_SCRIPTS

config BR2_PACKAGE_MONIT
	bool "monit"
	depends on BR2_TOOLCHAIN_HAS_THREADS
	depends on BR2_USE_MMU # fork()
	select BR2_PACKAGE_LIBXCRYPT if BR2_TOOLCHAIN_USES_GLIBC
	help
	  Monit is a free open source utility for managing and
	  monitoring, processes, programs, files, directories and
	  filesystems on a UNIX system. Monit conducts automatic
	  maintenance and repair and can execute meaningful causal
	  actions in error situations.

	  http://mmonit.com/monit/

comment "monit needs a toolchain w/ threads"
	depends on BR2_USE_MMU
	depends on !BR2_TOOLCHAIN_HAS_THREADS

endif #!BR2_BUILD_USE_CUSTOM_SCRIPTS
```

## buildroot/package/msmtp/Config.in
```kconfig
if BR2_BUILD_USE_CUSTOM_SCRIPTS
if BR2_BUILD_USE_ASTLINUX_SCRIPTS

config BR2_PACKAGE_MSMTP
	bool "msmtp"
	select BR2_PACKAGE_LIBRETLS
	default n
	help
	  msmtp is an MUA/MTa like ssmtp, only better

	  https://marlam.de/msmtp/

endif

endif #BR2_BUILD_USE_CUSTOM_SCRIPTS

if !BR2_BUILD_USE_CUSTOM_SCRIPTS

config BR2_PACKAGE_MSMTP
	bool "msmtp"
	help
	  msmtp is an SMTP client. In the default mode, it transmits a
	  mail to an SMTP server (for example at a free mail provider)
	  which takes care of further delivery.

	  https://marlam.de/msmtp/

endif #!BR2_BUILD_USE_CUSTOM_SCRIPTS
```

## buildroot/package/mtr/Config.in
```kconfig
if BR2_BUILD_USE_CUSTOM_SCRIPTS
if BR2_BUILD_USE_ASTLINUX_SCRIPTS

config BR2_PACKAGE_MTR
	bool "mtr"
 	default n
	select BR2_PACKAGE_NCURSES
	select BR2_PACKAGE_LIBCAP
	help
	  My TraceRoute
	  mtr combines the functionality of the 'traceroute' and 'ping'
	  programs in a single network diagnostic tool.
	  	  
	  https://github.com/traviscross/mtr


endif

endif #BR2_BUILD_USE_CUSTOM_SCRIPTS

if !BR2_BUILD_USE_CUSTOM_SCRIPTS

config BR2_PACKAGE_MTR
	bool "mtr"
	depends on BR2_USE_MMU # fork()
	help
	  mtr combines the functionality of the 'traceroute' and 'ping'
	  programs in a single network diagnostic tool.

	  http://www.bitwizard.nl/mtr/

endif #!BR2_BUILD_USE_CUSTOM_SCRIPTS
```

## buildroot/package/neon/Config.in
```kconfig
if BR2_BUILD_USE_CUSTOM_SCRIPTS
if BR2_BUILD_USE_ASTLINUX_SCRIPTS

config BR2_PACKAGE_NEON
	bool "libneon"
	help
	  HTTP and WebDAV client library, with a C interface.

	  http://www.webdav.org/neon/

if BR2_PACKAGE_NEON

config BR2_PACKAGE_NEON_ZLIB
	bool "ZLIB support"
	#depends on BR2_PACKAGE_NEON
	select BR2_PACKAGE_ZLIB
	help
	  build with ZLIB support

config BR2_PACKAGE_NEON_SSL
	bool "SSL support"
	#depends on BR2_PACKAGE_NEON
	select BR2_PACKAGE_OPENSSL
	help
	  build with SSL support

#choice
#	prompt "XML Support"
#	#depends on BR2_PACKAGE_NEON
#	help
#	  Select which XML library to use...
#	  none       do not build with XML support
#	  expat      use expat
#	  libxml2    use libxml2

config BR2_PACKAGE_NEON_NOXML
	bool "none"
	help
	  none       do not build with XML support

config BR2_PACKAGE_NEON_EXPAT
	bool "expat"
	select BR2_PACKAGE_EXPAT
	help
	  expat      use expat, a library for parsing XML.

config BR2_PACKAGE_NEON_LIBXML2
	bool "libxml2"
	select BR2_PACKAGE_LIBXML2
	help
	  libxml2    use libxml2, a library to read, modify and
	             write XML and HTML files.
#endchoice

endif

endif

endif #BR2_BUILD_USE_CUSTOM_SCRIPTS

if !BR2_BUILD_USE_CUSTOM_SCRIPTS

config BR2_PACKAGE_NEON
	bool "libneon"
	help
	  HTTP and WebDAV client library, with a C interface.

	  https://notroj.github.io/neon/

if BR2_PACKAGE_NEON

config BR2_PACKAGE_NEON_ZLIB
	bool "ZLIB support"
	select BR2_PACKAGE_ZLIB
	help
	  build with ZLIB support

config BR2_PACKAGE_NEON_SSL
	bool "SSL support"
	select BR2_PACKAGE_OPENSSL
	select BR2_PACKAGE_LIBOPENSSL_ENABLE_DES if BR2_PACKAGE_LIBOPENSSL
	select BR2_PACKAGE_LIBOPENSSL_ENABLE_MD4 if BR2_PACKAGE_LIBOPENSSL
	help
	  build with SSL support

# This is an hidden symbol other packages can select to ensure that
# Neon has XML support, either provided by Expat or libxml2.
config BR2_PACKAGE_NEON_XML
	bool
	select BR2_PACKAGE_NEON_EXPAT if !BR2_PACKAGE_NEON_LIBXML2

config BR2_PACKAGE_NEON_EXPAT
	bool "XML support with expat"
	depends on !BR2_PACKAGE_NEON_LIBXML2
	select BR2_PACKAGE_EXPAT
	help
	  Enable XML support in neon, using the Expat XML library.

config BR2_PACKAGE_NEON_LIBXML2
	bool "XML support with libxml2"
	select BR2_PACKAGE_LIBXML2
	help
	  Enable XML support in neon, using the libxml2 XML library.

endif

endif #!BR2_BUILD_USE_CUSTOM_SCRIPTS
```
