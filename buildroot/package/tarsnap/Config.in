## buildroot/package/tcpdump/Config.in
```kconfig
if BR2_BUILD_USE_ASTLINUX_SCRIPTS

include package/tcpdump/astlinux/Config.in

else #BR2_BUILD_USE_CUSTOM_SCRIPTS

config BR2_PACKAGE_TCPDUMP
	bool "tcpdump"
	select BR2_PACKAGE_LIBPCAP
	help
	  A tool for network monitoring and data acquisition.

	  https://www.tcpdump.org/

if BR2_PACKAGE_TCPDUMP

config BR2_PACKAGE_TCPDUMP_SMB
	bool "smb dump support"
	help
	  enable possibly-buggy SMB printer

endif

endif #BR2_BUILD_USE_CUSTOM_SCRIPTS
```

## buildroot/package/tinyproxy/Config.in
```kconfig
if BR2_BUILD_USE_CUSTOM_SCRIPTS
if BR2_BUILD_USE_ASTLINUX_SCRIPTS
source package/tinyproxy/astlinux/Config.in
endif

endif #BR2_BUILD_USE_CUSTOM_SCRIPTS

if !BR2_BUILD_USE_CUSTOM_SCRIPTS

config BR2_PACKAGE_TINYPROXY
	bool "tinyproxy"
	depends on BR2_USE_WCHAR
	depends on BR2_TOOLCHAIN_HAS_THREADS
	depends on BR2_USE_MMU # fork()
	help
	  Tinyproxy is a small, efficient HTTP/SSL proxy daemon released
	  under the GNU General Public License. Tinyproxy is very
	  useful in a small network setting, where a larger proxy would
	  be too resource intensive.

	  https://tinyproxy.github.io

comment "tinyproxy needs a toolchain w/ threads, wchar"
	depends on !BR2_TOOLCHAIN_HAS_THREADS || !BR2_USE_WCHAR
	depends on BR2_USE_MMU

endif #!BR2_BUILD_USE_CUSTOM_SCRIPTS
```

## buildroot/package/unionfs/Config.in
```kconfig
if BR2_BUILD_USE_ASTLINUX_SCRIPTS

include package/unionfs/astlinux/Config.in

else #BR2_BUILD_USE_CUSTOM_SCRIPTS

config BR2_PACKAGE_UNIONFS
	bool "unionfs (FUSE)"
	depends on BR2_TOOLCHAIN_HAS_THREADS # libfuse
	depends on BR2_USE_MMU # libfuse
	depends on !BR2_STATIC_LIBS # libfuse
	select BR2_PACKAGE_LIBFUSE
	help
	  A userspace unionfs implementation.

	  https://github.com/rpodgorny/unionfs-fuse

comment "unionfs needs a toolchain w/ threads, dynamic library"
	depends on BR2_USE_MMU
	depends on !BR2_TOOLCHAIN_HAS_THREADS || BR2_STATIC_LIBS

endif #BR2_BUILD_USE_CUSTOM_SCRIPTS
```

## buildroot/package/unixodbc/Config.in
```kconfig
if BR2_BUILD_USE_ASTLINUX_SCRIPTS

include package/unixodbc/astlinux/Config.in

else #BR2_BUILD_USE_CUSTOM_SCRIPTS

config BR2_PACKAGE_UNIXODBC
	bool "unixodbc"
	depends on !BR2_STATIC_LIBS # dlopen()
	help
	  The unixODBC Project goals are to develop and promote
	  unixODBC to be the definitive standard for ODBC on non MS
	  Windows platforms.

	  http://www.unixodbc.org

comment "unixodbc needs a toolchain w/ dynamic library"
	depends on BR2_STATIC_LIBS

endif #BR2_BUILD_USE_CUSTOM_SCRIPTS
```

## buildroot/package/usbutils/Config.in
```kconfig
if BR2_BUILD_USE_CUSTOM_SCRIPTS
if BR2_BUILD_USE_ASTLINUX_SCRIPTS
source package/usbutils/astlinux/Config.in
endif

endif #BR2_BUILD_USE_CUSTOM_SCRIPTS

if !BR2_BUILD_USE_CUSTOM_SCRIPTS

config BR2_PACKAGE_USBUTILS
	bool "usbutils"
	depends on BR2_TOOLCHAIN_HAS_THREADS # libusb
	depends on BR2_TOOLCHAIN_GCC_AT_LEAST_4_9 # libusb
	depends on BR2_PACKAGE_HAS_UDEV # needs hwdb
	select BR2_PACKAGE_LIBICONV if !BR2_ENABLE_LOCALE
	select BR2_PACKAGE_LIBUSB
	help
	  USB enumeration utilities

	  http://linux-usb.sourceforge.net/

comment "usbutils needs udev /dev management and toolchain w/ threads, gcc >= 4.9"
	depends on !BR2_TOOLCHAIN_HAS_THREADS || \
		!BR2_PACKAGE_HAS_UDEV || \
		!BR2_TOOLCHAIN_GCC_AT_LEAST_4_9

endif #!BR2_BUILD_USE_CUSTOM_SCRIPTS
```

## buildroot/package/vnstat/Config.in
```kconfig
if BR2_BUILD_USE_ASTLINUX_SCRIPTS

include package/vnstat/astlinux/Config.in

else #BR2_BUILD_USE_CUSTOM_SCRIPTS

config BR2_PACKAGE_VNSTAT
	bool "vnstat"
	depends on BR2_USE_MMU # fork()
	depends on BR2_USE_WCHAR # mbstowcs()
	select BR2_PACKAGE_SQLITE
	help
	  vnStat is a console-based network traffic monitor that keeps a
	  log of network traffic for the selected interface(s). It uses
	  the network interface statistics provided by the kernel as
	  information source. This means that vnStat won't actually be
	  sniffing any traffic and also ensures light use of system
	  resources.

	  http://humdi.net/vnstat

comment "vnstat needs a toolchain w/ wchar"
	depends on BR2_USE_MMU
	depends on !BR2_USE_WCHAR

endif #BR2_BUILD_USE_CUSTOM_SCRIPTS
```

## buildroot/package/whois/Config.in
```kconfig
if BR2_BUILD_USE_CUSTOM_SCRIPTS
if BR2_BUILD_USE_ASTLINUX_SCRIPTS

config BR2_PACKAGE_WHOIS
	bool "whois"
	depends on BR2_USE_WCHAR # gettext
	help
	  Improved whois client.

	  https://github.com/rfc1036/whois


endif

endif #BR2_BUILD_USE_CUSTOM_SCRIPTS

if !BR2_BUILD_USE_CUSTOM_SCRIPTS

config BR2_PACKAGE_WHOIS
	bool "whois"
	depends on BR2_PACKAGE_BUSYBOX_SHOW_OTHERS
	select BR2_PACKAGE_LIBXCRYPT if BR2_TOOLCHAIN_USES_GLIBC
	help
	  Improved whois client.

	  https://github.com/rfc1036/whois

endif #!BR2_BUILD_USE_CUSTOM_SCRIPTS
```
