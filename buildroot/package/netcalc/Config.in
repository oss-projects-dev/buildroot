## buildroot/package/sox/Config.in
```kconfig
if BR2_BUILD_USE_CUSTOM_SCRIPTS
if BR2_BUILD_USE_ASTLINUX_SCRIPTS

config BR2_PACKAGE_SOX
	bool "sox"
	default n
	help
	  SoX is a cross-platform (Windows, Linux, MacOS X, etc.) command line
	  utility that can convert various formats of computer audio files
	  into other formats.
	  It can also apply various effects to these sound files, and, as an
	  added bonus, SoX can play and record audio files on most platforms.

	  http://sox.sourceforge.net/


endif

endif #BR2_BUILD_USE_CUSTOM_SCRIPTS

if !BR2_BUILD_USE_CUSTOM_SCRIPTS

config BR2_PACKAGE_SOX
	bool "sox"
	help
	  SoX is a cross-platform (Windows, Linux, MacOS X, etc.)
	  command line utility that can convert various formats of
	  computer audio files into other formats.

	  It can also apply various effects to these sound files, and,
	  as an added bonus, SoX can play and record audio files on
	  most platforms.

	  http://sox.sourceforge.net/

endif #!BR2_BUILD_USE_CUSTOM_SCRIPTS
```

## buildroot/package/spandsp/Config.in
```kconfig
if BR2_BUILD_USE_CUSTOM_SCRIPTS
if BR2_BUILD_USE_ASTLINUX_SCRIPTS

config BR2_PACKAGE_SPANDSP
	bool "spandsp"
	default n
	select BR2_PACKAGE_TIFF
	help
	  spandsp - spandsp library and rxfax/txfax for Asterisk  

	  http://www.soft-switch.org/downloads/snapshots/spandsp/spandsp-20061116.tar.gz


endif

endif #BR2_BUILD_USE_CUSTOM_SCRIPTS

if !BR2_BUILD_USE_CUSTOM_SCRIPTS

config BR2_PACKAGE_SPANDSP
	bool "spandsp"
	select BR2_PACKAGE_TIFF
	select BR2_PACKAGE_TIFF_JPEG
	help
	  Spandsp is a library of many DSP functions for telephony.
	  These range from simple modules, such as DTMF detection, to
	  a complete software FAX machine.

	  https://github.com/freeswitch/spandsp

endif #!BR2_BUILD_USE_CUSTOM_SCRIPTS
```

## buildroot/package/statserial/Config.in
```kconfig
if BR2_BUILD_USE_CUSTOM_SCRIPTS
if BR2_BUILD_USE_ASTLINUX_SCRIPTS
source package/statserial/astlinux/Config.in
endif

endif #BR2_BUILD_USE_CUSTOM_SCRIPTS

if !BR2_BUILD_USE_CUSTOM_SCRIPTS

config BR2_PACKAGE_STATSERIAL
	bool "statserial"
	select BR2_PACKAGE_NCURSES
	help
	  Displays a table of the signals on a standard
	  9-pin or 25-pin serial port, and indicates the
	  status of the handshaking lines. It can be
	  useful for debugging problems with serial
	  ports or modems.

	  https://sites.google.com/site/tranter/software

endif #!BR2_BUILD_USE_CUSTOM_SCRIPTS
```

## buildroot/package/stunnel/Config.in
```kconfig
if BR2_BUILD_USE_CUSTOM_SCRIPTS
if BR2_BUILD_USE_ASTLINUX_SCRIPTS
source package/stunnel/astlinux/Config.in
endif

endif #BR2_BUILD_USE_CUSTOM_SCRIPTS

if !BR2_BUILD_USE_CUSTOM_SCRIPTS

config BR2_PACKAGE_STUNNEL
	bool "stunnel"
	depends on BR2_USE_MMU # fork()
	select BR2_PACKAGE_OPENSSL
	select BR2_PACKAGE_OPENSSL_FORCE_LIBOPENSSL
	select BR2_PACKAGE_LIBOPENSSL_ENABLE_DES
	help
	  Stunnel is a program that wraps any TCP connection with an SSL
	  connection.

	  http://www.stunnel.org/

endif #!BR2_BUILD_USE_CUSTOM_SCRIPTS
```

## buildroot/package/sudo/Config.in
```kconfig
if BR2_BUILD_USE_CUSTOM_SCRIPTS
if BR2_BUILD_USE_ASTLINUX_SCRIPTS

config BR2_PACKAGE_SUDO
	bool "sudo"
	help
	  Sudo is a program designed to allow a sysadmin to give
	  limited root privileges to users and log root activity.  The
	  basic philosophy is to give as few privileges as possible
	  but still allow people to get their work done.

	  http://www.sudo.ws/sudo/

endif

endif #BR2_BUILD_USE_CUSTOM_SCRIPTS

if !BR2_BUILD_USE_CUSTOM_SCRIPTS

config BR2_PACKAGE_SUDO
	bool "sudo"
	# uses fork()
	depends on BR2_USE_MMU
	select BR2_PACKAGE_LIBXCRYPT if BR2_TOOLCHAIN_USES_GLIBC
	help
	  Sudo is a program designed to allow a sysadmin to give
	  limited root privileges to users and log root activity. The
	  basic philosophy is to give as few privileges as possible
	  but still allow people to get their work done.

	  https://www.sudo.ws/sudo/

endif #!BR2_BUILD_USE_CUSTOM_SCRIPTS
```
