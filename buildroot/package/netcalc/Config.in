## buildroot/package/netcalc/Config.in
```kconfig
if BR2_BUILD_USE_CUSTOM_SCRIPTS
if BR2_BUILD_USE_ASTLINUX_SCRIPTS

config BR2_PACKAGE_NETCALC
	bool "netcalc"
	help
	  netcalc is a slimmed down clone of sipcalc, using the output
	  format of ipcalc. It is written in C and has very few dependencies.
	  Both IPv4 and IPv6 is supported.

	  https://github.com/troglobit/netcalc


endif

endif #BR2_BUILD_USE_CUSTOM_SCRIPTS

if !BR2_BUILD_USE_CUSTOM_SCRIPTS

config BR2_PACKAGE_NETCALC
	bool "netcalc"
	help
	  netcalc (40 kiB) is a slimmed down version of sipcalc
	  using the popular output format of ipcalc.  Both IPv4
	  and IPv6 are supported.

	  https://github.com/troglobit/netcalc/

endif #!BR2_BUILD_USE_CUSTOM_SCRIPTS
```

## buildroot/package/newt/Config.in
```kconfig
if BR2_BUILD_USE_CUSTOM_SCRIPTS
if BR2_BUILD_USE_ASTLINUX_SCRIPTS

config BR2_PACKAGE_NEWT
	bool "newt"
	select BR2_PACKAGE_SLANG
	help
	  Programming library for color text mode, widget based user interfaces.

	  http://www.redhat.com/

endif

endif #BR2_BUILD_USE_CUSTOM_SCRIPTS

if !BR2_BUILD_USE_CUSTOM_SCRIPTS

config BR2_PACKAGE_NEWT
	bool "newt"
	depends on BR2_USE_WCHAR
	depends on BR2_USE_MMU # slang
	depends on !BR2_STATIC_LIBS # unconditionally creates .so
	select BR2_PACKAGE_SLANG
	select BR2_PACKAGE_POPT
	help
	  Programming library for color text mode, widget based user
	  interfaces.

	  http://www.redhat.com/

comment "newt needs a toolchain w/ wchar, dynamic library"
	depends on BR2_USE_MMU
	depends on !BR2_USE_WCHAR || BR2_STATIC_LIBS

endif #!BR2_BUILD_USE_CUSTOM_SCRIPTS
```

## buildroot/package/ngrep/Config.in
```kconfig
if BR2_BUILD_USE_CUSTOM_SCRIPTS
if BR2_BUILD_USE_ASTLINUX_SCRIPTS

config BR2_PACKAGE_NGREP
	bool "ngrep"
	default n
	select BR2_PACKAGE_LIBPCAP
	select BR2_PACKAGE_PCRE2
	help
	  Network grep.

	  https://github.com/jpr5/ngrep/

endif

endif #BR2_BUILD_USE_CUSTOM_SCRIPTS

if !BR2_BUILD_USE_CUSTOM_SCRIPTS

config BR2_PACKAGE_NGREP
	bool "ngrep"
	select BR2_PACKAGE_LIBPCAP
	select BR2_PACKAGE_PCRE
	help
	  Network grep.

	  https://github.com/jpr5/ngrep/

endif #!BR2_BUILD_USE_CUSTOM_SCRIPTS
```

## buildroot/package/openldap/Config.in
```kconfig
if BR2_BUILD_USE_CUSTOM_SCRIPTS
if BR2_BUILD_USE_ASTLINUX_SCRIPTS

config BR2_PACKAGE_OPENLDAP
	bool "openldap"
	select BR2_PACKAGE_OPENSSL
	help
	  OpenLDAP Software is an open source implementation of the
	  Lightweight Directory Access Protocol.

	  The suite includes:
	  - slapd: stand-alone LDAP daemon (optional server)
	  - libraries: implementing the LDAP protocol
	  - utilities, tools, and sample clients (ex. ldapsearch)

	  http://www.openldap.org/

config BR2_PACKAGE_OPENLDAP_SERVER
	bool "openldap-server"
	default n
	depends on BR2_PACKAGE_OPENLDAP
	help
	  Include slapd and server related files.


endif

endif #BR2_BUILD_USE_CUSTOM_SCRIPTS

if !BR2_BUILD_USE_CUSTOM_SCRIPTS

config BR2_PACKAGE_OPENLDAP
	bool "openldap"
	depends on BR2_USE_WCHAR
	depends on BR2_USE_MMU # needs fork()
	help
	  OpenLDAP Software is an open source implementation of the
	  Lightweight Directory Access Protocol.

	  This only installs client-side support.

	  https://www.openldap.org/

if BR2_PACKAGE_OPENLDAP

config BR2_PACKAGE_OPENLDAP_CLIENTS
	bool "openldap client binaries"
	default y
	help
	  Install the OpenLDAP client tools (ldapadd, ldapcompare,
	  ldapdelete, ldapexop, ldapmodify, ldapmodrdn, ldappasswd,
	  ldapsearch, ldapurl, ldapwhoami)

endif

comment "openldap needs a toolchain w/ wchar"
	depends on BR2_USE_MMU # needs fork()
	depends on !BR2_USE_WCHAR

endif #!BR2_BUILD_USE_CUSTOM_SCRIPTS
```

## buildroot/package/p910nd/Config.in
```kconfig
if BR2_BUILD_USE_ASTLINUX_SCRIPTS

include package/p910nd/astlinux/Config.in

else #BR2_BUILD_USE_CUSTOM_SCRIPTS

config BR2_PACKAGE_P910ND
	bool "p910nd"
	depends on BR2_USE_MMU # fork()
	help
	  p910nd is a small printer daemon intended for diskless
	  workstations. Using ports 9100-9102, it accepts
	  print jobs and passes them directly to a USB printer.

	  http://p910nd.sourceforge.net/

endif #BR2_BUILD_USE_CUSTOM_SCRIPTS
```

## buildroot/package/pciutils/Config.in
```kconfig
if BR2_BUILD_USE_CUSTOM_SCRIPTS
if BR2_BUILD_USE_ASTLINUX_SCRIPTS

config BR2_PACKAGE_PCIUTILS
	bool "pciutils"
	depends on BR2_LINUX_KERNEL
	help
	  Various utilities dealing with the PCI bus.
	  Provides things like setpci and lspci.

	  You'll need a copy of pci.ids or pci.ids.gz in your
	  target skeleton to enjoy verbose output.

	  http://atrey.karlin.mff.cuni.cz/~mj/pciutils.html

endif

endif #BR2_BUILD_USE_CUSTOM_SCRIPTS

if !BR2_BUILD_USE_CUSTOM_SCRIPTS

config BR2_PACKAGE_PCIUTILS
	bool "pciutils"
	help
	  Various utilities dealing with the PCI bus.
	  Provides things like setpci and lspci.

	  https://mj.ucw.cz/sw/pciutils/

endif #!BR2_BUILD_USE_CUSTOM_SCRIPTS
```

## buildroot/package/perl/Config.in
```kconfig
if BR2_BUILD_USE_CUSTOM_SCRIPTS
if BR2_BUILD_USE_ASTLINUX_SCRIPTS

config BR2_PACKAGE_PERL
	bool "perl"
	depends on BR2_LINUX_KERNEL
	default n
	help
	  Larry Wall's Practical Extraction and Report Language
	  An interpreted scripting language, known among some as "Unix's Swiss
	  Army Chainsaw".
	  
	  Perl:
	  http://www.perl.org/
	  
	  Perl-Cross:
	  http://arsv.github.io/perl-cross/


endif

endif #BR2_BUILD_USE_CUSTOM_SCRIPTS

if !BR2_BUILD_USE_CUSTOM_SCRIPTS

config BR2_PACKAGE_PERL
	bool "perl"
	depends on BR2_USE_MMU # fork()
	help
	  Larry Wall's Practical Extraction and Report Language
	  An interpreted scripting language, known among some as
	  "Unix's Swiss Army Chainsaw".

	  http://www.perl.org/

if BR2_PACKAGE_PERL

config BR2_PACKAGE_PERL_MODULES
	string "custom module selection"
	help
	  List of space-separated perl modules (without .pm) to copy
	  to the rootfs.

	  Examples: constant Getopt/Std Time/Local

	  Module dependencies on external libraries are not automatic so
	  check your needs.

	  Leave empty for all modules (as far as the external libraries
	  are available).

config BR2_PACKAGE_PERL_THREADS
	bool "thread support"
	depends on BR2_TOOLCHAIN_HAS_THREADS
	help
	  Enable use of threads in Perl scripts

	  WARNING: The use of interpreter-based threads in Perl
	  is officially discouraged.
	  See https://perldoc.perl.org/threads.html#WARNING

endif

endif #!BR2_BUILD_USE_CUSTOM_SCRIPTS
```

## buildroot/package/php/Config.in
```kconfig
if BR2_BUILD_USE_CUSTOM_SCRIPTS
if BR2_BUILD_USE_ASTLINUX_SCRIPTS

config BR2_PACKAGE_PHP
	bool "php"
	help
	  PHP  is a widely-used general-purpose scripting
	  language that is especially suited for Web development
	  and can be embedded into HTML.

	  http://www.php.net

if BR2_PACKAGE_PHP

config BR2_PACKAGE_PHP_CLI
	bool

config BR2_PACKAGE_PHP_CGI
	bool

config BR2_PACKAGE_PHP_FPM
	bool

choice
	prompt "PHP interface"
	default BR2_PACKAGE_PHP_SAPI_CGI
	help
	  Select the PHP interface(s).

config BR2_PACKAGE_PHP_SAPI_CGI
	bool "cgi interface"
	select BR2_PACKAGE_PHP_CGI
	help
	  Common Gateway Interface

config BR2_PACKAGE_PHP_SAPI_CLI
	bool "cli interface"
	select BR2_PACKAGE_PHP_CLI
	help
	  Command Line Interface

config BR2_PACKAGE_PHP_SAPI_FPM
	bool "fpm interface"
	select BR2_PACKAGE_PHP_FPM
	help
	  PHP-FPM (FastCGI Process Manager)

config BR2_PACKAGE_PHP_SAPI_CLI_CGI
	bool "cli and cgi interfaces"
	select BR2_PACKAGE_PHP_CLI
	select BR2_PACKAGE_PHP_CGI
	help
	  Command line and Common gateway interfaces

config BR2_PACKAGE_PHP_SAPI_CLI_FPM
	bool "cli and fpm interfaces"
	select BR2_PACKAGE_PHP_CLI
	select BR2_PACKAGE_PHP_FPM
	help
	  Command line and PHP-FPM (FastCGI Process Manager)

endchoice

source "package/php/Config.ext"
endif

endif

endif #BR2_BUILD_USE_CUSTOM_SCRIPTS

if !BR2_BUILD_USE_CUSTOM_SCRIPTS

config BR2_PACKAGE_PHP_ARCH_SUPPORTS
	bool
	# see fiber_cpu in configure.ac
	default y if BR2_aarch64 || BR2_aarch64_be
	default y if BR2_arm || BR2_armeb
	default y if BR2_i386 || BR2_x86_64
	default y if BR2_mips || BR2_mipsel || BR2_mips64 || BR2_mips64el
	default y if BR2_powerpc || BR2_powerpc64 || BR2_powerpc64le
	default y if BR2_RISCV_64
	default y if BR2_s390x
	default y if BR2_TOOLCHAIN_HAS_UCONTEXT
	default y if BR2_PACKAGE_LIBUCONTEXT_ARCH_SUPPORTS

config BR2_PACKAGE_PHP
	bool "php"
	depends on BR2_PACKAGE_PHP_ARCH_SUPPORTS
	# PHP uses -export-dynamic, which breaks with elf2flt with a
	# message like "ld.real: section .junk LMA [...,...] overlaps
	# section .text LMA [...,...]"
	depends on !BR2_BINFMT_FLAT
	depends on BR2_USE_WCHAR
	select BR2_PACKAGE_PHP_SAPI_CGI if \
	       !BR2_PACKAGE_PHP_SAPI_APACHE && \
	       !BR2_PACKAGE_PHP_SAPI_CLI && \
	       !BR2_PACKAGE_PHP_SAPI_FPM &&  \
	       BR2_USE_MMU
	select BR2_PACKAGE_PHP_SAPI_CLI if !BR2_USE_MMU
	select BR2_PACKAGE_PCRE2
	select BR2_PACKAGE_LIBUCONTEXT if \
		BR2_PACKAGE_LIBUCONTEXT_ARCH_SUPPORTS
	help
	  PHP  is a widely-used general-purpose scripting
	  language that is especially suited for Web development
	  and can be embedded into HTML.

	  http://www.php.net

if BR2_PACKAGE_PHP

config BR2_PACKAGE_PHP_SAPI_APACHE
	bool "Apache interface"
	depends on BR2_PACKAGE_APACHE
	help
	  Apache module

config BR2_PACKAGE_PHP_SAPI_CGI
	bool "CGI interface"
	# CGI uses fork()
	depends on BR2_USE_MMU
	help
	  Common Gateway Interface

config BR2_PACKAGE_PHP_SAPI_CLI
	bool "CLI interface"
	help
	  Command Line Interface

config BR2_PACKAGE_PHP_SAPI_FPM
	bool "FPM interface"
	depends on BR2_USE_MMU
	# "Sparc v8 and predecessors are not and will not be supported"
	depends on !BR2_sparc
	help
	  PHP-FPM (FastCGI Process Manager)

source "package/php/Config.ext"

endif

comment "php needs a toolchain w/ wchar"
	depends on BR2_PACKAGE_PHP_ARCH_SUPPORTS
	depends on !BR2_BINFMT_FLAT
	depends on !BR2_USE_WCHAR

endif #!BR2_BUILD_USE_CUSTOM_SCRIPTS
```

## buildroot/package/popt/Config.in
```kconfig
if BR2_BUILD_USE_CUSTOM_SCRIPTS
if BR2_BUILD_USE_ASTLINUX_SCRIPTS
source package/popt/astlinux/Config.in
endif

endif #BR2_BUILD_USE_CUSTOM_SCRIPTS

if !BR2_BUILD_USE_CUSTOM_SCRIPTS

config BR2_PACKAGE_POPT
	bool "popt"
	help
	  Popt is a C library for parsing command line parameters.

	  https://github.com/rpm-software-management/popt

endif #!BR2_BUILD_USE_CUSTOM_SCRIPTS
```

## buildroot/package/pppd/Config.in
```kconfig
if BR2_BUILD_USE_CUSTOM_SCRIPTS
if BR2_BUILD_USE_ASTLINUX_SCRIPTS

config BR2_PACKAGE_PPPD
	select BR2_PACKAGE_OPENSSL
	select BR2_PACKAGE_LIBPCAP
	bool "pppd"
	help
	  An implementation of the Point-to-point protocol.

	  https://github.com/paulusmack/ppp


endif

endif #BR2_BUILD_USE_CUSTOM_SCRIPTS

if !BR2_BUILD_USE_CUSTOM_SCRIPTS

config BR2_PACKAGE_PPPD
	bool "pppd"
	depends on !BR2_STATIC_LIBS
	depends on BR2_USE_MMU
	select BR2_PACKAGE_OPENSSL if BR2_TOOLCHAIN_USES_GLIBC
	select BR2_PACKAGE_LIBOPENSSL_ENABLE_DES if BR2_PACKAGE_LIBOPENSSL
	help
	  An implementation of the Point-to-point protocol.

	  http://www.samba.org/ppp/

if BR2_PACKAGE_PPPD

config BR2_PACKAGE_PPPD_FILTER
	bool "filtering"
	select BR2_PACKAGE_LIBPCAP
	help
	  Packet filtering abilities for pppd. If enabled,
	  the pppd active-filter and pass-filter options
	  are available.

endif

comment "pppd needs a toolchain w/ dynamic library"
	depends on BR2_STATIC_LIBS
	depends on BR2_USE_MMU

endif #!BR2_BUILD_USE_CUSTOM_SCRIPTS
```

## buildroot/package/prosody/Config.in
```kconfig
if BR2_BUILD_USE_CUSTOM_SCRIPTS
if BR2_BUILD_USE_ASTLINUX_SCRIPTS

config BR2_PACKAGE_PROSODY
	bool "prosody"
	select BR2_PACKAGE_OPENSSL
	select BR2_PACKAGE_LIBIDN
	select BR2_PACKAGE_LUA
	select BR2_PACKAGE_LUABITOP
	select BR2_PACKAGE_LUAFILESYSTEM
	select BR2_PACKAGE_LUASOCKET
	select BR2_PACKAGE_LUASEC
	select BR2_PACKAGE_LUAEXPAT
	default n
	help
	  Prosody is a modern flexible communications server for Jabber/XMPP written in Lua

	  http://prosody.im/


endif

endif #BR2_BUILD_USE_CUSTOM_SCRIPTS

if !BR2_BUILD_USE_CUSTOM_SCRIPTS

config BR2_PACKAGE_PROSODY
	bool "prosody"
	depends on BR2_USE_MMU # fork
	depends on BR2_PACKAGE_HAS_LUAINTERPRETER
	depends on !BR2_PACKAGE_LUA_5_4
	depends on !BR2_STATIC_LIBS # luaexpat, luasec, luasocket, luafilesystem
	select BR2_PACKAGE_LUABITOP if BR2_PACKAGE_LUA_5_1 # runtime
	select BR2_PACKAGE_LUAEXPAT # runtime
	select BR2_PACKAGE_LUASEC # runtime
	select BR2_PACKAGE_LUASOCKET # runtime
	select BR2_PACKAGE_OPENSSL
	select BR2_PACKAGE_LIBIDN
	select BR2_PACKAGE_LUAFILESYSTEM # runtime
	help
	  Prosody is a modern XMPP communication server. It aims to be
	  easy to set up and configure, and efficient with system
	  resources.

	  https://prosody.im

comment "prosody needs the lua interpreter, dynamic library"
	depends on !BR2_PACKAGE_HAS_LUAINTERPRETER || BR2_STATIC_LIBS
	depends on BR2_USE_MMU

comment "prosody needs a Lua <= 5.3"
	depends on BR2_PACKAGE_LUA_5_4

endif #!BR2_BUILD_USE_CUSTOM_SCRIPTS
```

## buildroot/package/rsync/Config.in
```kconfig
if BR2_BUILD_USE_CUSTOM_SCRIPTS
if BR2_BUILD_USE_ASTLINUX_SCRIPTS

config BR2_PACKAGE_RSYNC
	bool "rsync"
	select BR2_PACKAGE_ZLIB
	select BR2_PACKAGE_POPT
	help
	  File transfer program to keep remote files in sync.

	  https://rsync.samba.org/


endif

endif #BR2_BUILD_USE_CUSTOM_SCRIPTS

if !BR2_BUILD_USE_CUSTOM_SCRIPTS

config BR2_PACKAGE_RSYNC
	bool "rsync"
	# fork()
	depends on BR2_USE_MMU
	select BR2_PACKAGE_ZLIB
	select BR2_PACKAGE_POPT
	help
	  File transfer program to keep remote files in sync.

	  https://rsync.samba.org/

endif #!BR2_BUILD_USE_CUSTOM_SCRIPTS
```

## buildroot/package/shellinabox/Config.in
```kconfig
if BR2_BUILD_USE_CUSTOM_SCRIPTS
if BR2_BUILD_USE_ASTLINUX_SCRIPTS
source package/shellinabox/astlinux/Config.in
endif

endif #BR2_BUILD_USE_CUSTOM_SCRIPTS

if !BR2_BUILD_USE_CUSTOM_SCRIPTS

config BR2_PACKAGE_SHELLINABOX
	bool "shellinabox"
	depends on BR2_USE_MMU # fork()
	depends on !BR2_STATIC_LIBS # dlfcn.h
	select BR2_PACKAGE_OPENSSL
	select BR2_PACKAGE_ZLIB
	help
	  Shell In A Box implements a web server that can export
	  arbitrary command line tools to a web based terminal
	  emulator. This emulator is accessible to any JavaScript and
	  CSS enabled web browser and does not require any additional
	  browser plugins.

	  https://github.com/shellinabox/shellinabox

comment "shellinabox needs a toolchain w/ dynamic library"
	depends on BR2_USE_MMU
	depends on BR2_STATIC_LIBS

endif #!BR2_BUILD_USE_CUSTOM_SCRIPTS
```

## buildroot/package/slang/Config.in
```kconfig
if BR2_BUILD_USE_CUSTOM_SCRIPTS
if BR2_BUILD_USE_ASTLINUX_SCRIPTS

config BR2_PACKAGE_SLANG
	bool "slang"
	help
	  Multi-platform console display library.

	  http://www.s-lang.org/

endif

endif #BR2_BUILD_USE_CUSTOM_SCRIPTS

if !BR2_BUILD_USE_CUSTOM_SCRIPTS

config BR2_PACKAGE_SLANG
	bool "slang"
	depends on BR2_USE_MMU # fork()
	help
	  Multi-platform console display library.

	  http://www.jedsoft.org/slang/index.html

if BR2_PACKAGE_SLANG

config BR2_PACKAGE_SLANG_SLSH
	bool "enable slsh"
	help
	  Enable the S-lang interpreter

endif

endif #!BR2_BUILD_USE_CUSTOM_SCRIPTS
```

## buildroot/package/smartmontools/Config.in
```kconfig
if BR2_BUILD_USE_ASTLINUX_SCRIPTS

include package/smartmontools/astlinux/Config.in

else #BR2_BUILD_USE_CUSTOM_SCRIPTS

config BR2_PACKAGE_SMARTMONTOOLS
	bool "smartmontools"
	depends on BR2_INSTALL_LIBSTDCPP
	depends on BR2_USE_MMU # fork()
	help
	  Control and monitor storage systems using S.M.A.R.T.

	  http://smartmontools.sourceforge.net/

comment "smartmontools needs a toolchain w/ C++"
	depends on BR2_USE_MMU
	depends on !BR2_INSTALL_LIBSTDCPP

endif #BR2_BUILD_USE_CUSTOM_SCRIPTS
```
