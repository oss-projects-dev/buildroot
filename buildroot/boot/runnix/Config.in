## buildroot/configs/pc_x86_64_astlinux_astlinux_ast20_defconfig
```kconfig
BR2_x86_64=y
BR2_TOOLCHAIN_EXTERNAL=y
BR2_TOOLCHAIN_EXTERNAL_CUSTOM=y
BR2_TOOLCHAIN_EXTERNAL_PATH="$(HOME)/x86_64-buildroot-linux-gnu_sdk-buildroot-13.5.0"
BR2_TOOLCHAIN_EXTERNAL_CUSTOM_PREFIX="x86_64-buildroot-linux-gnu"
BR2_TOOLCHAIN_EXTERNAL_GCC_13=y
BR2_TOOLCHAIN_EXTERNAL_HEADERS_6_12=y
BR2_TOOLCHAIN_EXTERNAL_CUSTOM_GLIBC=y
# BR2_TOOLCHAIN_EXTERNAL_INET_RPC is not set
BR2_TOOLCHAIN_EXTERNAL_CXX=y
BR2_TOOLCHAIN_EXTERNAL_FORTRAN=y
BR2_TOOLCHAIN_EXTERNAL_OPENMP=y
BR2_TARGET_OPTIMIZATION="-pipe"
BR2_BACKUP_SITE=""
BR2_JLEVEL=1
BR2_OPTIMIZE_S=y
BR2_ROOTFS_SKELETON_CUSTOM=y
BR2_ROOTFS_SKELETON_CUSTOM_PATH="project/astlinux/target_skeleton"
BR2_ROOTFS_DEVICE_CREATION_DYNAMIC_EUDEV=y
BR2_ROOTFS_DEVICE_TABLE="project/astlinux/device_table.txt"
BR2_ROOTFS_POST_BUILD_SCRIPT="scripts/astlinux-post-build"
BR2_ROOTFS_POST_SCRIPT_ARGS="$(TOPDIR)"
BR2_LINUX_KERNEL=y
BR2_LINUX_KERNEL_CUSTOM_TARBALL=y
BR2_LINUX_KERNEL_CUSTOM_TARBALL_LOCATION="https://www.kernel.org/pub/linux/kernel/projects/cip/6.12/linux-cip-6.12.114-cip34.tar.xz"
BR2_LINUX_KERNEL_PATCH="project/astlinux/kernel-patches"
BR2_LINUX_KERNEL_USE_CUSTOM_CONFIG=y
BR2_LINUX_KERNEL_CUSTOM_CONFIG_FILE="project/astlinux/genx86_64/linux-smp.config"
BR2_LINUX_KERNEL_INSTALL_TARGET=y
BR2_LINUX_KERNEL_NEEDS_HOST_LIBELF=y
BR2_BUILD_USE_CUSTOM_SCRIPTS=y
BR2_BUILD_USE_ASTLINUX_SCRIPTS=y
BR2_PACKAGE_BUSYBOX_CONFIG="project/astlinux/busybox.config"
BR2_PACKAGE_BEEP=y
BR2_PACKAGE_SOX=y
BR2_PACKAGE_KEXEC=y
BR2_PACKAGE_STRACE=y
BR2_PACKAGE_FOSSIL=y
BR2_PACKAGE_DOSFSTOOLS=y
BR2_PACKAGE_DOSFSTOOLS_MKDOSFS=y
BR2_PACKAGE_DOSFSTOOLS_DOSFSCK=y
BR2_PACKAGE_DOSFSTOOLS_DOSFSLABEL=y
BR2_PACKAGE_S3FS=y
BR2_PACKAGE_UNIONFS=y
BR2_PACKAGE_LINUX_FIRMWARE=y
BR2_PACKAGE_R8125=y
BR2_PACKAGE_ACPID=y
BR2_PACKAGE_DAHDI_OSLEC=y
BR2_PACKAGE_DAHDI_TOOLS=y
BR2_PACKAGE_FXLOAD=y
BR2_PACKAGE_JITTERENTROPY_RNGD=y
BR2_PACKAGE_LM_SENSORS=y
BR2_PACKAGE_PCIUTILS=y
BR2_PACKAGE_SMARTMONTOOLS=y
BR2_PACKAGE_STATSERIAL=y
BR2_PACKAGE_USBUTILS=y
BR2_PACKAGE_PHP=y
BR2_PACKAGE_PHP_SAPI_CGI=y
BR2_PACKAGE_PHP_EXT_OPENSSL=y
BR2_PACKAGE_PHP_EXT_CURL=y
BR2_PACKAGE_PHP_EXT_XMLPARSER=y
BR2_PACKAGE_PHP_EXT_SIMPLEXML=y
BR2_PACKAGE_PHP_EXT_JSON=y
BR2_PACKAGE_PHP_EXT_ZIP=y
BR2_PACKAGE_PHP_EXT_FILTER=y
BR2_PACKAGE_PHP_EXT_PDO=y
BR2_PACKAGE_PHP_EXT_PDO_SQLITE=y
BR2_PACKAGE_WEBINTERFACE=y
BR2_PACKAGE_LIBMAD=y
BR2_PACKAGE_SPANDSP=y
BR2_PACKAGE_ACME=y
BR2_PACKAGE_CA_CERTIFICATES=y
BR2_PACKAGE_LIBOPENSSL_BIN=y
BR2_PACKAGE_LIBOPENSSL_ENGINES=y
BR2_PACKAGE_SQLITEODBC=y
BR2_PACKAGE_LIBJPEG=y
BR2_PACKAGE_LIBQRENCODE=y
BR2_PACKAGE_LIBQRENCODE_TOOLS=y
BR2_PACKAGE_BFDETECT=y
BR2_PACKAGE_LIBPRI=y
BR2_PACKAGE_IKSEMEL=y
BR2_PACKAGE_JANSSON=y
BR2_PACKAGE_LIBSRTP=y
BR2_PACKAGE_LIBURIPARSER=y
BR2_PACKAGE_NEON=y
BR2_PACKAGE_NEON_ZLIB=y
BR2_PACKAGE_NEON_SSL=y
BR2_PACKAGE_NEON_LIBXML2=y
BR2_PACKAGE_OPENLDAP=y
BR2_PACKAGE_OPENLDAP_SERVER=y
BR2_PACKAGE_PJSIP_AST20=y
BR2_PACKAGE_LIBICAL=y
BR2_PACKAGE_LIBEDIT=y
BR2_PACKAGE_MSMTP=y
BR2_PACKAGE_BC=y
BR2_PACKAGE_EMPTY=y
BR2_PACKAGE_HTPASSWD=y
BR2_PACKAGE_IPRANGE=y
BR2_PACKAGE_SYSTEM_VENDOR=y
BR2_PACKAGE_ZONEINFO=y
BR2_PACKAGE_ARNOFW=y
BR2_PACKAGE_ARP_SCAN=y
BR2_PACKAGE_ASTERISK=y
BR2_PACKAGE_ASTERISK_CODEC_SILK=y
BR2_PACKAGE_ASTERISK_FOP2=y
BR2_PACKAGE_AVAHI=y
BR2_PACKAGE_BRIDGE_UTILS=y
BR2_PACKAGE_CHRONY=y
BR2_PACKAGE_CLIX=y
BR2_PACKAGE_DARKSTAT=y
BR2_PACKAGE_DDCLIENT=y
BR2_PACKAGE_DHCPDUMP=y
BR2_PACKAGE_DNSCRYPT_PROXY=y
BR2_PACKAGE_DNSMASQ=y
BR2_PACKAGE_ETHTOOL=y
BR2_PACKAGE_GNTP_SEND=y
BR2_PACKAGE_IFTOP=y
BR2_PACKAGE_IPERF=y
BR2_PACKAGE_IPERF3=y
BR2_PACKAGE_IPROUTE2=y
BR2_PACKAGE_IPSET=y
BR2_PACKAGE_KEEPALIVED=y
BR2_PACKAGE_LIGHTTPD=y
BR2_PACKAGE_LIGHTTPD_OPENSSL=y
BR2_PACKAGE_LIGHTTPD_PCRE=y
BR2_PACKAGE_MINIUPNPD=y
BR2_PACKAGE_MTR=y
BR2_PACKAGE_NETSNMP=y
BR2_PACKAGE_NGREP=y
BR2_PACKAGE_OPENSSH=y
BR2_PACKAGE_OPENVPN=y
BR2_PACKAGE_P910ND=y
BR2_PACKAGE_PHONEPROV_TOOLS=y
BR2_PACKAGE_PPPD=y
BR2_PACKAGE_PROSODY=y
BR2_PACKAGE_RSYNC=y
BR2_PACKAGE_SHELLINABOX=y
BR2_PACKAGE_SIPGREP=y
BR2_PACKAGE_SIPSAK=y
BR2_PACKAGE_SNGREP=y
BR2_PACKAGE_STRONGSWAN=y
BR2_PACKAGE_STUNNEL=y
BR2_PACKAGE_TARSNAP=y
BR2_PACKAGE_TCPDUMP=y
BR2_PACKAGE_TINYPROXY=y
BR2_PACKAGE_UNBOUND=y
BR2_PACKAGE_VNSTAT=y
BR2_PACKAGE_VSFTPD=y
BR2_PACKAGE_WHOIS=y
BR2_PACKAGE_WIDE_DHCPV6=y
BR2_PACKAGE_WIREGUARD_TOOLS=y
BR2_PACKAGE_ZABBIX=y
BR2_PACKAGE_ZABBIX_PROXY=y
# BR2_PACKAGE_URANDOM_SCRIPTS is not set
BR2_PACKAGE_BASH=y
BR2_PACKAGE_DIALOG=y
BR2_PACKAGE_LOGROTATE=y
BR2_PACKAGE_SCREEN=y
BR2_PACKAGE_SUDO=y
BR2_PACKAGE_HTOP=y
BR2_PACKAGE_KMOD_TOOLS=y
BR2_PACKAGE_LXC=y
BR2_PACKAGE_MONIT=y
BR2_PACKAGE_NUT=y
BR2_PACKAGE_UTIL_LINUX_NSENTER=y
BR2_PACKAGE_EX_VI=y
BR2_PACKAGE_NANO=y
BR2_PACKAGE_NE=y
BR2_TARGET_ROOTFS_EXT2=y
BR2_TARGET_ROOTFS_EXT2_SIZE="185M"
BR2_TARGET_ROOTFS_EXT2_RESBLKS=0
BR2_TARGET_ROOTFS_SQUASHFS=y
# BR2_TARGET_ROOTFS_TAR is not set
BR2_TARGET_RUNNIX=y
```

## buildroot/configs/pc_x86_64_astlinux_initrd_defconfig
```kconfig
BR2_x86_64=y
BR2_TOOLCHAIN_EXTERNAL=y
BR2_TOOLCHAIN_EXTERNAL_CUSTOM=y
BR2_TOOLCHAIN_EXTERNAL_PATH="$(HOME)/x86_64-buildroot-linux-gnu_sdk-buildroot-13.5.0"
BR2_TOOLCHAIN_EXTERNAL_CUSTOM_PREFIX="x86_64-buildroot-linux-gnu"
BR2_TOOLCHAIN_EXTERNAL_GCC_13=y
BR2_TOOLCHAIN_EXTERNAL_HEADERS_6_12=y
BR2_TOOLCHAIN_EXTERNAL_CUSTOM_GLIBC=y
# BR2_TOOLCHAIN_EXTERNAL_INET_RPC is not set
BR2_TOOLCHAIN_EXTERNAL_CXX=y
BR2_TOOLCHAIN_EXTERNAL_FORTRAN=y
BR2_TOOLCHAIN_EXTERNAL_OPENMP=y
BR2_TARGET_OPTIMIZATION="-pipe"
BR2_BACKUP_SITE=""
BR2_JLEVEL=1
BR2_OPTIMIZE_S=y
BR2_ROOTFS_SKELETON_CUSTOM=y
BR2_ROOTFS_SKELETON_CUSTOM_PATH="project/initrd/target_skeleton"
BR2_ROOTFS_DEVICE_TABLE="project/initrd/device_table.txt"
BR2_BUILD_USE_CUSTOM_SCRIPTS=y
BR2_BUILD_USE_ASTLINUX_SCRIPTS=y
BR2_PACKAGE_BUSYBOX_CONFIG="project/initrd/busybox.config"
# BR2_PACKAGE_URANDOM_SCRIPTS is not set
BR2_PACKAGE_UTIL_LINUX=y
# BR2_PACKAGE_UTIL_LINUX_LIBFDISK is not set
BR2_PACKAGE_UTIL_LINUX_MINIMAL_BINARIES=y
# BR2_PACKAGE_UTIL_LINUX_CAL is not set
# BR2_PACKAGE_UTIL_LINUX_HWCLOCK is not set
# BR2_PACKAGE_UTIL_LINUX_IPCRM is not set
# BR2_PACKAGE_UTIL_LINUX_IPCS is not set
# BR2_PACKAGE_UTIL_LINUX_LOGGER is not set
# BR2_PACKAGE_UTIL_LINUX_MORE is not set
# BR2_PACKAGE_UTIL_LINUX_PG is not set
# BR2_PACKAGE_UTIL_LINUX_SCHEDUTILS is not set
# BR2_PACKAGE_UTIL_LINUX_SETTERM is not set
# BR2_PACKAGE_UTIL_LINUX_WDCTL is not set
BR2_TARGET_ROOTFS_EXT2=y
BR2_TARGET_ROOTFS_EXT2_RESBLKS=0
BR2_TARGET_ROOTFS_EXT2_GZIP=y
# BR2_TARGET_ROOTFS_TAR is not set
```

## buildroot/configs/pc_x86_64_astlinux_runnix_defconfig
```kconfig
BR2_x86_64=y
BR2_TOOLCHAIN_EXTERNAL=y
BR2_TOOLCHAIN_EXTERNAL_CUSTOM=y
BR2_TOOLCHAIN_EXTERNAL_PATH="$(HOME)/x86_64-buildroot-linux-gnu_sdk-buildroot-13.5.0"
BR2_TOOLCHAIN_EXTERNAL_CUSTOM_PREFIX="x86_64-buildroot-linux-gnu"
BR2_TOOLCHAIN_EXTERNAL_GCC_13=y
BR2_TOOLCHAIN_EXTERNAL_HEADERS_6_12=y
BR2_TOOLCHAIN_EXTERNAL_CUSTOM_GLIBC=y
# BR2_TOOLCHAIN_EXTERNAL_INET_RPC is not set
BR2_TOOLCHAIN_EXTERNAL_CXX=y
BR2_TOOLCHAIN_EXTERNAL_FORTRAN=y
BR2_TOOLCHAIN_EXTERNAL_OPENMP=y
BR2_TARGET_OPTIMIZATION="-pipe"
BR2_BACKUP_SITE=""
BR2_JLEVEL=1
BR2_OPTIMIZE_S=y
BR2_ROOTFS_SKELETON_CUSTOM=y
BR2_ROOTFS_SKELETON_CUSTOM_PATH="project/runnix/target_skeleton"
BR2_ROOTFS_DEVICE_TABLE="project/runnix/device_table.txt"
BR2_ROOTFS_POST_BUILD_SCRIPT="scripts/runnix-post-build"
BR2_LINUX_KERNEL=y
BR2_LINUX_KERNEL_CUSTOM_TARBALL=y
BR2_LINUX_KERNEL_CUSTOM_TARBALL_LOCATION="https://www.kernel.org/pub/linux/kernel/projects/cip/6.12/linux-cip-6.12.114-cip34.tar.xz"
BR2_LINUX_KERNEL_PATCH="project/astlinux/kernel-patches"
BR2_LINUX_KERNEL_USE_CUSTOM_CONFIG=y
BR2_LINUX_KERNEL_CUSTOM_CONFIG_FILE="project/runnix/genx86_64/linux.config"
BR2_BUILD_USE_CUSTOM_SCRIPTS=y
BR2_BUILD_USE_ASTLINUX_SCRIPTS=y
BR2_PACKAGE_BUSYBOX_CONFIG="project/runnix/busybox.config"
BR2_PACKAGE_KEXEC=y
BR2_PACKAGE_DOSFSTOOLS=y
BR2_PACKAGE_DOSFSTOOLS_MKDOSFS=y
BR2_PACKAGE_DOSFSTOOLS_DOSFSCK=y
BR2_PACKAGE_DOSFSTOOLS_DOSFSLABEL=y
BR2_PACKAGE_E2FSPROGS=y
BR2_PACKAGE_ZLIB=y
BR2_PACKAGE_DROPBEAR=y
BR2_PACKAGE_DROPBEAR_DISABLE_REVERSEDNS=y
# BR2_PACKAGE_URANDOM_SCRIPTS is not set
BR2_PACKAGE_DIALOG=y
BR2_PACKAGE_UTIL_LINUX_MINIMAL_BINARIES=y
# BR2_PACKAGE_UTIL_LINUX_CAL is not set
# BR2_PACKAGE_UTIL_LINUX_HWCLOCK is not set
# BR2_PACKAGE_UTIL_LINUX_IPCRM is not set
# BR2_PACKAGE_UTIL_LINUX_IPCS is not set
# BR2_PACKAGE_UTIL_LINUX_LOGGER is not set
# BR2_PACKAGE_UTIL_LINUX_SCHEDUTILS is not set
# BR2_PACKAGE_UTIL_LINUX_SETTERM is not set
# BR2_PACKAGE_UTIL_LINUX_WDCTL is not set
BR2_TARGET_ROOTFS_EXT2=y
BR2_TARGET_ROOTFS_EXT2_RESBLKS=0
BR2_TARGET_ROOTFS_EXT2_GZIP=y
# BR2_TARGET_ROOTFS_TAR is not set
BR2_TARGET_SYSLINUX=y
BR2_TARGET_SYSLINUX_LEGACY_BIOS=y
BR2_TARGET_SYSLINUX_EFI=y
```

## buildroot/configs/pc_x86_64_astlinux_toolchain14_defconfig
```kconfig
BR2_x86_64=y
BR2_KERNEL_HEADERS_CUSTOM_TARBALL=y
BR2_KERNEL_HEADERS_CUSTOM_TARBALL_LOCATION="https://www.kernel.org/pub/linux/kernel/projects/cip/6.12/linux-cip-6.12.114-cip34.tar.xz"
BR2_PACKAGE_HOST_LINUX_HEADERS_CUSTOM_6_12=y
BR2_PACKAGE_GLIBC_KERNEL_COMPAT=y
BR2_PACKAGE_GLIBC_UTILS=y
BR2_BINUTILS_VERSION_2_44_X=y
BR2_BINUTILS_GPROFNG=y
BR2_GCC_VERSION_14_X=y
BR2_TOOLCHAIN_BUILDROOT_CXX=y
BR2_TOOLCHAIN_BUILDROOT_FORTRAN=y
BR2_GCC_ENABLE_OPENMP=y
BR2_GCC_ENABLE_GRAPHITE=y
BR2_BACKUP_SITE=""
BR2_DOWNLOAD_FORCE_CHECK_HASHES=y
BR2_INIT_NONE=y
BR2_ROOTFS_DEVICE_CREATION_STATIC=y
# BR2_TARGET_ENABLE_ROOT_LOGIN is not set
BR2_SYSTEM_BIN_SH_NONE=y
# BR2_TARGET_GENERIC_GETTY is not set
# BR2_TARGET_GENERIC_REMOUNT_ROOTFS_RW is not set
# BR2_ENABLE_LOCALE_PURGE is not set
# BR2_PACKAGE_BUSYBOX is not set
# BR2_PACKAGE_IFUPDOWN_SCRIPTS is not set
# BR2_TARGET_ROOTFS_TAR is not set
```

## buildroot/package/acpid/Config.in
```kconfig
if BR2_BUILD_USE_CUSTOM_SCRIPTS
if BR2_BUILD_USE_ASTLINUX_SCRIPTS
source package/acpid/astlinux/Config.in
endif

endif #BR2_BUILD_USE_CUSTOM_SCRIPTS

if !BR2_BUILD_USE_CUSTOM_SCRIPTS

config BR2_PACKAGE_ACPID
	bool "acpid"
	depends on BR2_USE_MMU # fork()
	help
	  Advanced Configuration and Power Interface event daemon.

	  Acpid is designed to notify user-space programs of ACPI
	  events, and allows you to configure specific actions for
	  specific events.

	  http://sourceforge.net/projects/acpid2/

endif #!BR2_BUILD_USE_CUSTOM_SCRIPTS
```

## buildroot/package/arp-scan/Config.in
```kconfig
if BR2_BUILD_USE_CUSTOM_SCRIPTS
if BR2_BUILD_USE_ASTLINUX_SCRIPTS

config BR2_PACKAGE_ARP_SCAN
	bool "arp-scan"
	default n
	select BR2_PACKAGE_LIBPCAP
	# mac2vendor is only a runtime dependency
	select BR2_PACKAGE_MAC2VENDOR
	help
	  The ARP scanner

	  https://github.com/royhills/arp-scan/

	  http://linux.die.net/man/1/arp-scan


endif

endif #BR2_BUILD_USE_CUSTOM_SCRIPTS

if !BR2_BUILD_USE_CUSTOM_SCRIPTS

config BR2_PACKAGE_ARP_SCAN
	bool "arp-scan"
	select BR2_PACKAGE_LIBPCAP
	help
	  The ARP scanner

	  arp-scan is a command-line tool that uses the ARP protocol to
	  discover and fingerprint IP hosts on the local network.

	  https://github.com/royhills/arp-scan

if BR2_PACKAGE_ARP_SCAN

config BR2_PACKAGE_ARP_SCAN_DATA
	bool "install data (OUI)"
	default y  # legacy
	help
	  Say 'y' here (the default) to install the data along the
	  binaries.

endif # BR2_PACKAGE_ARP_SCAN

endif #!BR2_BUILD_USE_CUSTOM_SCRIPTS
```

## buildroot/package/asterisk/Config.in
```kconfig
if BR2_BUILD_USE_CUSTOM_SCRIPTS
if BR2_BUILD_USE_ASTLINUX_SCRIPTS

config BR2_PACKAGE_ASTERISK
	bool "asterisk"
	default n
	select BR2_PACKAGE_NCURSES
	select BR2_PACKAGE_ZLIB
	select BR2_PACKAGE_OPENSSL
	select BR2_PACKAGE_LIBTOOL
	select BR2_PACKAGE_UTIL_LINUX
	select BR2_PACKAGE_SQLITE
	help
		Asterisk - the Open Source PBX

choice
	prompt "Asterisk Version"
	depends on BR2_PACKAGE_ASTERISK
	default BR2_PACKAGE_ASTERISK_v20
	help
		Select which version of Asterisk to compile and install.

	config BR2_PACKAGE_ASTERISK_v18se
		bool "Asterisk v18.x SE"
		help
			Asterisk LTS Series, Stable Edition

	config BR2_PACKAGE_ASTERISK_v20
		bool "Asterisk v20.x"
		help
			Asterisk LTS Series, Latest Version
endchoice

comment "cdr_mysql, app_mysql and res_config_mysql - disabled (requires MYSQL_CLIENT)"
        depends on !BR2_PACKAGE_MYSQL_CLIENT && BR2_PACKAGE_ASTERISK
comment "cdr_mysql, app_mysql and res_config_mysql - enabled"
        depends on BR2_PACKAGE_MYSQL_CLIENT && BR2_PACKAGE_ASTERISK

comment "app_voicemail=IMAP_STORAGE - disabled (requires UW_IMAP)"
        depends on !BR2_PACKAGE_UW_IMAP && BR2_PACKAGE_ASTERISK
comment "app_voicemail=IMAP_STORAGE - enabled"
        depends on BR2_PACKAGE_UW_IMAP && BR2_PACKAGE_ASTERISK

config BR2_PACKAGE_ASTERISK_MENUSELECT
	bool "Asterisk custom configure"
	default n
	depends on BR2_PACKAGE_ASTERISK
	help
	  Run interactive menuselect to select custom Asterisk options


endif

endif #BR2_BUILD_USE_CUSTOM_SCRIPTS

if !BR2_BUILD_USE_CUSTOM_SCRIPTS

config BR2_PACKAGE_ASTERISK
	bool "asterisk"
	depends on BR2_INSTALL_LIBSTDCPP
	depends on !BR2_STATIC_LIBS # dlfcn.h
	depends on !BR2_TOOLCHAIN_USES_MUSL
	depends on BR2_USE_MMU # libedit
	depends on BR2_TOOLCHAIN_HAS_THREADS
	depends on BR2_USE_WCHAR # libedit
	select BR2_PACKAGE_JANSSON
	select BR2_PACKAGE_LIBCURL
	select BR2_PACKAGE_LIBEDIT
	select BR2_PACKAGE_LIBILBC
	select BR2_PACKAGE_LIBPJSIP
	select BR2_PACKAGE_LIBXCRYPT if BR2_TOOLCHAIN_USES_GLIBC
	select BR2_PACKAGE_LIBXML2
	select BR2_PACKAGE_OPENSSL # bundled libjwt
	select BR2_PACKAGE_OPENSSL_FORCE_LIBOPENSSL # bundled libjwt
	select BR2_PACKAGE_SQLITE
	select BR2_PACKAGE_UTIL_LINUX
	select BR2_PACKAGE_UTIL_LINUX_LIBUUID
	help
	  Asterisk is an open source framework for building
	  communications applications. Asterisk turns an ordinary
	  computer into a communications server. Asterisk powers IP PBX
	  systems, VoIP gateways, conference servers and other custom
	  solutions. It is used by small businesses, large businesses,
	  call centers, carriers and government agencies, worldwide.
	  Asterisk is free and open source.

	  http://www.asterisk.org/

comment "asterisk needs a glibc or uClibc toolchain w/ C++, dynamic library, threads, wchar"
	depends on BR2_USE_MMU
	depends on BR2_TOOLCHAIN_USES_MUSL || !BR2_INSTALL_LIBSTDCPP \
		|| BR2_STATIC_LIBS || !BR2_TOOLCHAIN_HAS_THREADS \
		|| !BR2_USE_WCHAR

endif #!BR2_BUILD_USE_CUSTOM_SCRIPTS
```

## buildroot/package/bridge-utils/Config.in
```kconfig
if BR2_BUILD_USE_CUSTOM_SCRIPTS
if BR2_BUILD_USE_ASTLINUX_SCRIPTS
source package/bridge-utils/astlinux/Config.in
endif

endif #BR2_BUILD_USE_CUSTOM_SCRIPTS

if !BR2_BUILD_USE_CUSTOM_SCRIPTS

config BR2_PACKAGE_BRIDGE_UTILS
	bool "bridge-utils"
	help
	  Manage ethernet bridging; a way to connect networks together
	  to form a larger network.

	  This utility is DEPRECATED. No new features will ever be
	  added. Instead use the bridge command from the iproute2
	  package which supports more features.

	  https://wiki.linuxfoundation.org/networking/bridge

endif #!BR2_BUILD_USE_CUSTOM_SCRIPTS
```

## buildroot/package/chrony/Config.in
```kconfig
if BR2_BUILD_USE_CUSTOM_SCRIPTS
if BR2_BUILD_USE_ASTLINUX_SCRIPTS

config BR2_PACKAGE_CHRONY
	bool "chrony"
	select BR2_PACKAGE_LIBCAP
	help
	  An NTP client and server designed to perform well in a wide range
	  of conditions. It can synchronize the system clock with NTP servers,
	  reference clocks, and manual input using wristwatch and keyboard.

	  https://chrony-project.org/


endif

endif #BR2_BUILD_USE_CUSTOM_SCRIPTS

if !BR2_BUILD_USE_CUSTOM_SCRIPTS

config BR2_PACKAGE_CHRONY
	bool "chrony"
	depends on BR2_USE_MMU # fork()
	select BR2_PACKAGE_LIBCAP
	help
	  Chrony is a pair of programs which are used to maintain the
	  accuracy of the system clock.

	  https://chrony-project.org/

if BR2_PACKAGE_CHRONY

config BR2_PACKAGE_CHRONY_DEBUG_LOGGING
	bool "enable debug logging support"
	help
	  Enable support for debug logging output from Chrony when
	  enabled at runtime. If disabled, code for debug logging will
	  not be compiled in.

endif

endif #!BR2_BUILD_USE_CUSTOM_SCRIPTS
```
