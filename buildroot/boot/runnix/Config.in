## buildroot/package/dahdi-linux/Config.in
```kconfig
if BR2_BUILD_USE_CUSTOM_SCRIPTS
if BR2_BUILD_USE_ASTLINUX_SCRIPTS

config BR2_PACKAGE_DAHDI_LINUX
	bool "dahdi-linux"
	default n
	depends on BR2_LINUX_KERNEL
	select BR2_PACKAGE_LIBUSB
	select BR2_PACKAGE_LIBUSB_COMPAT
	help
		Dahdi - Linux drivers and utilities for Digium cards
		for use with Asterisk:

		http://www.asterisk.org

config BR2_PACKAGE_DAHDI_OSLEC
	bool "dahdi_echocan_oslec"
	default n
	depends on BR2_PACKAGE_DAHDI_LINUX
	help
		Adds modules "echo" and "dahdi_echocan_oslec"

		http://www.rowetel.com/blog/?page_id=454

config BR2_PACKAGE_DAHDI_NO_CARD_FIRMWARE
	bool "dahdi_no_card_firmware"
	default n
	depends on BR2_PACKAGE_DAHDI_LINUX
	help
		Reduce image size by removing PCI / PCI-e card firmware files.

		It saves 8.8 MB (DAHDI 2.10) of uncompressed space.


endif

endif #BR2_BUILD_USE_CUSTOM_SCRIPTS

if !BR2_BUILD_USE_CUSTOM_SCRIPTS

config BR2_PACKAGE_DAHDI_LINUX
	bool "dahdi-linux"
	depends on BR2_LINUX_KERNEL
	help
	  DAHDI (Digium/Asterisk Hardware Device Interface) is the open
	  source device interface technology used to control Digium and
	  other legacy telephony interface cards.

	  DAHDI Linux is the open source device driver framework used to
	  interface Asterisk with telephony hardware.

	  https://github.com/asterisk/dahdi-linux

comment "dahdi-linux needs a Linux kernel to be built"
	depends on !BR2_LINUX_KERNEL

endif #!BR2_BUILD_USE_CUSTOM_SCRIPTS
```

## buildroot/package/dahdi-tools/Config.in
```kconfig
if BR2_BUILD_USE_CUSTOM_SCRIPTS
if BR2_BUILD_USE_ASTLINUX_SCRIPTS

config BR2_PACKAGE_DAHDI_TOOLS
	bool "dahdi-tools"
	default n
	depends on BR2_LINUX_KERNEL
	select BR2_PACKAGE_DAHDI_LINUX
	select BR2_PACKAGE_LIBUSB
	select BR2_PACKAGE_LIBUSB_COMPAT
	select BR2_PACKAGE_NEWT
	help
		Dahdi - Linux utilities for Digium cards
		for use with Asterisk:

		http://www.asterisk.org


endif

endif #BR2_BUILD_USE_CUSTOM_SCRIPTS

if !BR2_BUILD_USE_CUSTOM_SCRIPTS

config BR2_PACKAGE_DAHDI_TOOLS
	bool "dahdi-tools"
	depends on BR2_TOOLCHAIN_HAS_THREADS
	depends on BR2_LINUX_KERNEL # dahdi-linux
	depends on BR2_USE_MMU # perl
	select BR2_PACKAGE_DAHDI_LINUX
	select BR2_PACKAGE_PERL
	help
	  DAHDI (Digium/Asterisk Hardware Device Interface) is the open
	  source device interface technology used to control Digium and
	  other legacy telephony interface cards.

	  DAHDI Tools is a package of utilities for managing and
	  monitoring DAHDI devices.

	  http://www.asterisk.org/downloads/dahdi

comment "dahdi-tools needs a toolchain w/ threads and a Linux kernel to be built"
	depends on !BR2_TOOLCHAIN_HAS_THREADS || !BR2_LINUX_KERNEL

endif #!BR2_BUILD_USE_CUSTOM_SCRIPTS
```

## buildroot/package/dhcpdump/Config.in
```kconfig
if BR2_BUILD_USE_CUSTOM_SCRIPTS
if BR2_BUILD_USE_ASTLINUX_SCRIPTS

config BR2_PACKAGE_DHCPDUMP
	bool "dhcpdump"
	select BR2_PACKAGE_LIBPCAP
	help
	  A tool for monitoring dhcp requests using tcpdump.

endif

endif #BR2_BUILD_USE_CUSTOM_SCRIPTS

if !BR2_BUILD_USE_CUSTOM_SCRIPTS

config BR2_PACKAGE_DHCPDUMP
	bool "dhcpdump"
	select BR2_PACKAGE_LIBPCAP
	help
	  A tool for monitoring dhcp requests using tcpdump.

	  https://github.com/bbonev/dhcpdump

endif #!BR2_BUILD_USE_CUSTOM_SCRIPTS
```

## buildroot/package/dialog/Config.in
```kconfig
if BR2_BUILD_USE_CUSTOM_SCRIPTS
if BR2_BUILD_USE_ASTLINUX_SCRIPTS

config BR2_PACKAGE_DIALOG
	bool "dialog"
	select BR2_PACKAGE_NCURSES
	select BR2_PACKAGE_LIBICONV if !BR2_ENABLE_LOCALE
	help
	  dialog - display dialog boxes from shell scripts

	  This application provides a method of displaying several different
	  types of dialog boxes from shell scripts.  This allows a developer
	  of a script to interact with the user in a much friendlier manner.

	  http://invisible-island.net/dialog/dialog.html

endif

endif #BR2_BUILD_USE_CUSTOM_SCRIPTS

if !BR2_BUILD_USE_CUSTOM_SCRIPTS

config BR2_PACKAGE_DIALOG
	bool "dialog"
	depends on BR2_USE_MMU # fork()
	select BR2_PACKAGE_NCURSES
	select BR2_PACKAGE_LIBICONV if !BR2_ENABLE_LOCALE
	help
	  dialog - display dialog boxes from shell scripts

	  This application provides a method of displaying several
	  different types of dialog boxes from shell scripts. This
	  allows a developer of a script to interact with the user in a
	  much friendlier manner.

	  http://invisible-island.net/dialog/dialog.html

endif #!BR2_BUILD_USE_CUSTOM_SCRIPTS
```

## buildroot/package/dosfstools/Config.in
```kconfig
if BR2_BUILD_USE_CUSTOM_SCRIPTS
if BR2_BUILD_USE_ASTLINUX_SCRIPTS

config BR2_PACKAGE_DOSFSTOOLS
	bool "dosfstools"
	depends on BR2_USE_WCHAR
	select BR2_PACKAGE_LIBICONV if !BR2_ENABLE_LOCALE
	help
	  Tools for creating and checking DOS FAT filesystems.

	  https://github.com/dosfstools/dosfstools

config BR2_PACKAGE_DOSFSTOOLS_MKDOSFS
	bool "mkdosfs"
	depends on BR2_PACKAGE_DOSFSTOOLS
	help
	  Creates a DOS FAT filesystem on a device.

config BR2_PACKAGE_DOSFSTOOLS_DOSFSCK
	bool "dosfsck"
	depends on BR2_PACKAGE_DOSFSTOOLS
	help
	  Checks a DOS FAT filesystem.

config BR2_PACKAGE_DOSFSTOOLS_DOSFSLABEL
	bool "dosfslabel"
	depends on BR2_PACKAGE_DOSFSTOOLS
	help
	  Get or set the DOS FAT filesystem label.

comment "dosfstools requires a toolchain with LARGEFILE and WCHAR support"
	depends on !BR2_USE_WCHAR

endif

endif #BR2_BUILD_USE_CUSTOM_SCRIPTS

if !BR2_BUILD_USE_CUSTOM_SCRIPTS

config BR2_PACKAGE_DOSFSTOOLS
	bool "dosfstools"
	depends on BR2_USE_WCHAR
	select BR2_PACKAGE_LIBICONV if !BR2_ENABLE_LOCALE
	help
	  Tools for creating and checking DOS FAT filesystems.

	  https://github.com/dosfstools/dosfstools

if BR2_PACKAGE_DOSFSTOOLS

config BR2_PACKAGE_DOSFSTOOLS_FATLABEL
	bool "fatlabel"
	help
	  Get or set the DOS FAT filesystem label.

config BR2_PACKAGE_DOSFSTOOLS_FSCK_FAT
	bool "fsck.fat"
	help
	  Check a DOS FAT filesystem.

config BR2_PACKAGE_DOSFSTOOLS_MKFS_FAT
	bool "mkfs.fat"
	help
	  Creates a DOS FAT filesystem on a device.

endif

comment "dosfstools needs a toolchain w/ wchar"
	depends on !BR2_USE_WCHAR

endif #!BR2_BUILD_USE_CUSTOM_SCRIPTS
```

## buildroot/package/empty/Config.in
```kconfig
if BR2_BUILD_USE_CUSTOM_SCRIPTS
if BR2_BUILD_USE_ASTLINUX_SCRIPTS

config BR2_PACKAGE_EMPTY
	bool "empty"
	depends on BR2_USE_MMU # uses fork()
	help
	  Run processes and applications under pseudo-terminal (PTY)
	  sessions. Similar functionality to "expect".

	  http://empty.sourceforge.net/

endif

endif #BR2_BUILD_USE_CUSTOM_SCRIPTS

if !BR2_BUILD_USE_CUSTOM_SCRIPTS

config BR2_PACKAGE_EMPTY
	bool "empty"
	depends on BR2_USE_MMU # uses fork()
	help
	  Run processes and applications under pseudo-terminal (PTY)
	  sessions.

	  http://empty.sourceforge.net/

endif #!BR2_BUILD_USE_CUSTOM_SCRIPTS
```
