## configs/pc_x86_64_toolchain15_defconfig
```kconfig
BR2_x86_64=y
BR2_KERNEL_HEADERS_VERSION=y
BR2_DEFAULT_KERNEL_VERSION="6.18.64"
BR2_PACKAGE_HOST_LINUX_HEADERS_CUSTOM_6_18=y
BR2_PACKAGE_GLIBC_KERNEL_COMPAT=y
BR2_PACKAGE_GLIBC_UTILS=y
BR2_BINUTILS_VERSION_2_45_X=y
BR2_BINUTILS_GPROFNG=y
BR2_GCC_VERSION_15_X=y
BR2_TOOLCHAIN_BUILDROOT_CXX=y
BR2_GCC_ENABLE_OPENMP=y
BR2_GCC_ENABLE_GRAPHITE=y
BR2_BACKUP_SITE=""
BR2_DOWNLOAD_FORCE_CHECK_HASHES=y
BR2_INIT_NONE=y
BR2_ROOTFS_DEVICE_CREATION_STATIC=y
# BR2_TARGET_ENABLE_ROOT_LOGIN is not set
BR2_SYSTEM_BIN_SH_NONE=y
# BR2_TARGET_GENERIC_GETTY is not set
# BR2_TARGET_GENERIC_REMOUNT_ROOTFS_RW is not set
# BR2_ENABLE_LOCALE_PURGE is not set
# BR2_PACKAGE_BUSYBOX is not set
# BR2_PACKAGE_IFUPDOWN_SCRIPTS is not set
# BR2_TARGET_ROOTFS_TAR is not set
```

## package/ipset/Config.in
```kconfig
if BR2_BUILD_USE_CUSTOM_SCRIPTS
if BR2_BUILD_USE_ASTLINUX_SCRIPTS

config BR2_PACKAGE_IPSET
	bool "ipset"
	#depends on BR2_LARGEFILE
	select BR2_PACKAGE_LIBMNL
	help
	  Utility to manage IP sets in the linux kernel.
	  Requires a patched kernel or version >=2.6.39.

	  http://ipset.netfilter.org/

#comment "ipset requires a toolchain with LARGEFILE support"
	#depends on !BR2_LARGEFILE

endif

endif #BR2_BUILD_USE_CUSTOM_SCRIPTS

if !BR2_BUILD_USE_CUSTOM_SCRIPTS

config BR2_PACKAGE_IPSET
	bool "ipset"
	select BR2_PACKAGE_LIBMNL
	help
	  Utility to manage IP sets in the linux kernel.
	  Requires a patched kernel or version >=2.6.39.

	  http://ipset.netfilter.org/

endif #!BR2_BUILD_USE_CUSTOM_SCRIPTS
```
